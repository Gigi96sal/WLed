#include "wled.h"
#include "remote_network.h"
#ifdef ARDUINO_ARCH_ESP32
#include <HTTPClient.h>
#include <mdns.h>

// AI: below section was generated by an AI
namespace ledwall {
constexpr uint32_t PROBE_PERIOD_MS = 10000;
constexpr size_t MAX_REMOTE_BODY = 16384;

// Read a bounded HTTP/1.0 body into caller-owned memory; redirects and chunked bodies are refused.
static int remoteRequest(const uint8_t* ip, const char* path, const char* payload, String& body) {
  WiFiClient client;
  HTTPClient http;
  const IPAddress address(ip[0], ip[1], ip[2], ip[3]);
  const String url = String(F("http://")) + address.toString() + path;
  http.setConnectTimeout(600);
  http.setTimeout(1000);
  http.useHTTP10(true);
  http.setReuse(false);
  if (!http.begin(client, url)) return -1;
  int code;
  if (payload) { http.addHeader(F("Content-Type"), F("application/json")); code = http.POST(payload); }
  else code = http.GET();
  if (code != 200 || http.getSize() > int(MAX_REMOTE_BODY)) { http.end(); return code == 200 ? -2 : code; }
  body = "";
  if (!body.reserve(http.getSize() > 0 ? size_t(http.getSize()) : 2048)) { http.end(); return -3; }
  WiFiClient* stream = http.getStreamPtr();
  const int expected = http.getSize();
  const uint32_t started = millis();
  while (millis() - started < 1500 && (http.connected() || stream->available())) {
    while (stream->available()) {
      if (body.length() == MAX_REMOTE_BODY) { http.end(); return -2; }
      const int byte = stream->read();
      if (byte >= 0) body += char(byte);
      if (expected >= 0 && body.length() == size_t(expected)) break;
    }
    if (expected >= 0 && body.length() == size_t(expected)) break;
    delay(1);
  }
  const bool complete = expected >= 0 ? body.length() == size_t(expected) : !http.connected();
  http.end();
  return complete ? 200 : -4;
}

// A reader tracks the consumed suffix, rejecting embedded NUL and trailing JSON values.
static bool decodeRemote(const String& body, DynamicJsonDocument& document) {
  for (size_t i = 0; i < body.length(); i++) if (!body[i]) return false;
  struct Reader {
    const String& body;
    size_t position = 0;
    int read() { return position < body.length() ? uint8_t(body[position++]) : -1; }
    size_t readBytes(char* output, size_t length) {
      size_t copied = 0;
      while (copied < length && position < body.length()) output[copied++] = body[position++];
      return copied;
    }
  } input{body};
  StaticJsonDocument<1536> filter;
  filter["success"] = true;
  for (const char* key : {"on", "bri", "lor"}) filter["state"][key] = true;
  for (const char* key : {"ver", "name", "live", "lm", "lip"}) filter["info"][key] = true;
  filter["info"]["leds"]["count"] = true;
  for (const char* key : {"start", "len", "type", "rev"}) filter["hw"]["led"]["ins"][0][key] = true;
  for (const char* key : {"mso", "rlm", "offset", "maxbri"}) filter["if"]["live"][key] = true;
  for (const char* key : {"addr", "seqskip"}) filter["if"]["live"]["dmx"][key] = true;
  if (filter.overflowed() || deserializeJson(document, input, DeserializationOption::Filter(filter), DeserializationOption::NestingLimit(16))) return false;
  while (input.position < body.length()) {
    const char c = body[input.position++];
    if (c != ' ' && c != '\r' && c != '\n' && c != '\t') return false;
  }
  return true;
}

// HTTP queries cannot target the master, the Internet, multicast or subnet broadcast addresses.
bool RemoteNetwork::allowed(const uint8_t* bytes) const {
  IPAddress ip(bytes[0], bytes[1], bytes[2], bytes[3]);
  if (!bytes[0] || bytes[0] == 127 || bytes[0] >= 224) return false;
  const IPAddress local = WLEDNetwork.localIP(), mask = WLEDNetwork.subnetMask(), ap = WiFi.softAPIP();
  if (ip == local || ip == ap) return false;
  auto subnet = [ip](IPAddress host, IPAddress netmask) {
    const uint32_t target = uint32_t(ip), bits = uint32_t(netmask);
    return host[0] && bits && (target & bits) == (uint32_t(host) & bits) && (target & ~bits) && (target | bits) != UINT32_MAX;
  };
  return subnet(local, mask) || (apActive && subnet(ap, WiFi.softAPSubnetMask()));
}

// Caller holds the cache mutex; configured devices are never evicted by discovery.
int RemoteNetwork::findOrAdd(const uint8_t* ip) {
  int slot = -1;
  for (size_t i = 0; i < MAX_DEVICES; i++) {
    if (!memcmp(_devices[i].ip, ip, 4)) return int(i);
    if (!_devices[i].ip[0]) slot = int(i);
  }
  if (slot < 0) {
    uint32_t oldest = 0;
    for (size_t i = 0; i < MAX_DEVICES; i++) {
      const uint32_t age = millis() - _devices[i].seen;
      if (!_devices[i].configured && !_devices[i].prepare && age > oldest) { oldest = age; slot = int(i); }
    }
  }
  if (slot >= 0) { _devices[slot] = Device(); memcpy(_devices[slot].ip, ip, 4); }
  return slot;
}

void RemoteNetwork::begin() {
  _mutex = xSemaphoreCreateMutex();
  if (!_mutex) return;
  _started = xTaskCreate(run, "ledwall-net", 8192, this, 1, nullptr) == pdPASS;
}

// Native discovery and config are main-loop-owned; copy them without network waits.
void RemoteNetwork::sync(const Config& config) {
  if (!_started || millis() - _nextSync < 1000) return;
  _nextSync = millis();
  if (xSemaphoreTake(_mutex, 0) != pdTRUE) return;
  for (Device& device : _devices) {
    device.configured = false;
    for (size_t i = 0; i < config.controllerCount; i++) if (!memcmp(device.ip, config.controllers[i].ip, 4)) device.configured = true;
  }
  for (size_t i = 0; i < config.controllerCount; i++) {
    if (!allowed(config.controllers[i].ip)) continue;
    const int index = findOrAdd(config.controllers[i].ip);
    if (index >= 0) _devices[index].configured = true;
  }
  for (const auto& item : Nodes) {
    uint8_t ip[4];
    for (size_t i = 0; i < 4; i++) ip[i] = item.second.ip[i];
    if (item.second.age > 2 || !allowed(ip)) continue;
    const int index = findOrAdd(ip);
    if (index >= 0) {
      _devices[index].seen = millis();
      if (!_devices[index].info.name[0]) strlcpy(_devices[index].info.name, item.second.nodeName.c_str(), sizeof(_devices[index].info.name));
    }
  }
  xSemaphoreGive(_mutex);
}

bool RemoteNetwork::requestProbe(const char* text) {
  IPAddress ip;
  if (!_started || !text || strnlen(text, 16) > 15 || !ip.fromString(text)) return false;
  uint8_t bytes[4]; for (size_t i = 0; i < 4; i++) bytes[i] = ip[i];
  if (!allowed(bytes) || xSemaphoreTake(_mutex, pdMS_TO_TICKS(10)) != pdTRUE) return false;
  const int index = findOrAdd(bytes);
  if (index >= 0) { _devices[index].urgent = true; _devices[index].seen = millis(); }
  xSemaphoreGive(_mutex);
  return index >= 0;
}

// This explicit user action changes only receiver realtime policy and runtime takeover state.
bool RemoteNetwork::requestPrepare(const char* text, const char* pin) {
  if (pin && pin[0]) {
    if (strnlen(pin, 5) != 4) return false;
    for (size_t i = 0; i < 4; i++) if (pin[i] < '0' || pin[i] > '9') return false;
  }
  if (!requestProbe(text)) return false;
  IPAddress ip; ip.fromString(text);
  if (xSemaphoreTake(_mutex, pdMS_TO_TICKS(10)) != pdTRUE) return false;
  for (Device& device : _devices) if (IPAddress(device.ip[0],device.ip[1],device.ip[2],device.ip[3]) == ip) {
    device.prepare = true;
    strlcpy(device.pin, pin ? pin : "", sizeof(device.pin));
    device.urgent = true;
  }
  xSemaphoreGive(_mutex);
  return true;
}

bool RemoteNetwork::requestScan() {
  if (!_started) return false;
  _scan.store(true);
  return true;
}

void RemoteNetwork::run(void* context) { static_cast<RemoteNetwork*>(context)->worker(); }

// Atomic breadcrumbs remain readable through USB even while a remote HTTP operation is stalled.
void RemoteNetwork::setPhase(const char* phase) {
  _phaseSince.store(millis());
  _phase.store(phase);
}

void RemoteNetwork::diagnostics(JsonObject object) const {
  object["available"] = _started;
  object["phase"] = _phase.load();
  object["phaseAgeMs"] = millis() - _phaseSince.load();
  object["heartbeatAgeMs"] = heartbeatAge();
  object["stackMinimumFreeBytes"] = stackFree();
  object["lastHttpCode"] = _lastHttpCode.load();
}

// Use result-owned mDNS storage, independent of Arduino MDNS's shared query cache.
void RemoteNetwork::discover() {
  setPhase("mdns");
  _scanning.store(true);
  mdns_result_t* results = nullptr;
  mdns_query_ptr("_wled", "_tcp", 1200, MAX_DEVICES, &results);
  for (mdns_result_t* result = results; result; result = result->next) {
    if (result->port != 80) continue;
    for (mdns_ip_addr_t* address = result->addr; address; address = address->next) {
      if (address->addr.type != MDNS_IP_PROTOCOL_V4) continue;
      const IPAddress ip(address->addr.u_addr.ip4.addr);
      uint8_t bytes[4]; for (size_t i = 0; i < 4; i++) bytes[i] = ip[i];
      if (!allowed(bytes) || xSemaphoreTake(_mutex, pdMS_TO_TICKS(10)) != pdTRUE) continue;
      const int index = findOrAdd(bytes);
      if (index >= 0) { _devices[index].seen = millis(); _devices[index].urgent = true; }
      xSemaphoreGive(_mutex);
    }
  }
  if (results) mdns_query_results_free(results);
  _scanning.store(false);
}

// Probe WLED before any optional writes. Read-back, not HTTP success alone, supplies diagnostics.
void RemoteNetwork::probe(Device& device) {
  String body;
  DynamicJsonDocument document(6144);
  device.online = false;
  device.error = "http_unreachable";
  setPhase("receiver_info");
  const int infoCode = remoteRequest(device.ip, "/json/si", nullptr, body);
  _lastHttpCode.store(infoCode);
  if (infoCode != 200) { device.prepare = false; return; }
  if (!decodeRemote(body, document) || !readRemoteInfo(document.as<JsonVariantConst>(), device.info)) {
    device.error = "not_wled_or_invalid_response"; device.prepare = false; return;
  }
  if (_paused.load()) { device.prepare = false; device.error = "paused_for_ota"; return; }
  device.online = true;
  const bool prepare = device.prepare;
  device.prepare = false;
  const char* preparationError = "";
  if (prepare) {
    setPhase("receiver_prepare");
    // Numeric PIN is validated at ingress and used in RAM for this request only.
    char payload[256];
    snprintf(payload, sizeof(payload), "{\"pin\":\"%s\",\"if\":{\"live\":{\"en\":true,\"mso\":false,\"rlm\":false,\"offset\":0,\"maxbri\":true,\"dmx\":{\"seqskip\":false,\"addr\":1}}}}", device.pin);
    const int code = remoteRequest(device.ip, "/json/cfg", payload, body);
    memset(device.pin, 0, sizeof(device.pin));
    document.clear();
    if (code != 200 || !decodeRemote(body, document) || document["success"] != true) preparationError = code == 401 ? "receiver_pin_required" : "receiver_prepare_failed";
    else if (remoteRequest(device.ip, "/json/state", "{\"on\":true,\"lor\":0,\"udpn\":{\"recv\":false}}", body) != 200) preparationError = "receiver_takeover_failed";
  }
  document.clear();
  device.info.configKnown = false;
  setPhase("receiver_config");
  const int configCode = remoteRequest(device.ip, "/json/cfg", nullptr, body);
  _lastHttpCode.store(configCode);
  if (configCode == 200 && decodeRemote(body, document) && readRemoteConfig(document.as<JsonVariantConst>(), device.info)) device.error = preparationError;
  else device.error = preparationError[0] ? preparationError : configCode == 401 ? "receiver_config_locked" : "receiver_config_unavailable";
  if (prepare && !preparationError[0]) {
    document.clear();
    if (remoteRequest(device.ip, "/json/si", nullptr, body) == 200 && decodeRemote(body, document)) readRemoteInfo(document.as<JsonVariantConst>(), device.info);
  }
}

// All slow operations run here, never inside WLED's frame loop or its HTTP callbacks.
void RemoteNetwork::worker() {
  uint32_t nextDiscovery = 0;
  size_t cursor = 0;
  while (true) {
    _heartbeat.store(millis());
    _stackFree.store(uxTaskGetStackHighWaterMark(nullptr));
    setPhase(_paused.load() ? "paused" : "idle");
    delay(20);
    if (_paused.load() || !(interfacesInited || apActive)) continue;
    if (_scan.exchange(false) || int32_t(millis() - nextDiscovery) >= 0) {
      discover(); nextDiscovery = millis() + 60000;
    }
    Device work;
    int selected = -1;
    if (xSemaphoreTake(_mutex, pdMS_TO_TICKS(10)) != pdTRUE) continue;
    // Round-robin prevents unreachable destinations from starving later entries.
    for (size_t offset = 0; offset < MAX_DEVICES; offset++) {
      const size_t i = (cursor + offset) % MAX_DEVICES;
      Device& device = _devices[i];
      if (!device.ip[0]) continue;
      if (device.urgent || !device.attempted || millis() - device.checked >= (device.configured ? PROBE_PERIOD_MS : 30000)) {
        selected = int(i); work = device; device.urgent = false; device.prepare = false;
        memset(device.pin, 0, sizeof(device.pin)); break;
      }
    }
    xSemaphoreGive(_mutex);
    if (selected < 0) continue;
    cursor = (size_t(selected) + 1) % MAX_DEVICES;
    if (allowed(work.ip)) probe(work);
    else { work.online = false; work.error = "address_not_on_local_network"; }
    memset(work.pin, 0, sizeof(work.pin));
    if (xSemaphoreTake(_mutex, pdMS_TO_TICKS(10)) != pdTRUE) continue;
    Device& device = _devices[selected];
    if (!memcmp(device.ip, work.ip, 4)) {
      device.info = work.info; device.online = work.online; device.error = work.error;
      device.attempted = true; device.checked = millis();
    }
    xSemaphoreGive(_mutex);
  }
}

// Serialize one small record at a time; full output inventories cannot overflow WLED's shared JSON doc.
bool RemoteNetwork::serve(AsyncWebServerRequest* request) {
  AsyncResponseStream* response = request->beginResponseStream(FPSTR(CONTENT_TYPE_JSON));
  if (!response) return false;
  response->addHeader(F("Cache-Control"), F("no-store"));
  response->print(F("{\"available\":")); response->print(_started ? F("true") : F("false"));
  response->print(F(",\"scanning\":")); response->print((_scanning.load() || _scan.load()) ? F("true") : F("false"));
  response->print(F(",\"limit\":16,\"devices\":["));
  DynamicJsonDocument document(4096);
  bool comma = false;
  if (_started) for (size_t i = 0; i < MAX_DEVICES; i++) {
    Device device;
    if (xSemaphoreTake(_mutex, pdMS_TO_TICKS(10)) != pdTRUE) { delete response; return false; }
    device = _devices[i];
    xSemaphoreGive(_mutex);
    if (!device.ip[0]) continue;
    JsonObject root = document.to<JsonObject>();
    root["ip"] = IPAddress(device.ip[0],device.ip[1],device.ip[2],device.ip[3]).toString();
    root["name"] = device.info.name;
    root["health"] = remoteHealth(device.attempted, device.online, millis() - device.checked);
    root["ageMs"] = device.attempted ? int32_t(millis() - device.checked) : -1;
    root["configured"] = device.configured; root["error"] = device.error;
    root["leds"] = device.info.leds; root["live"] = device.info.live;
    root["mode"] = device.info.mode; root["source"] = device.info.source;
    root["receivingFromMaster"] = device.online && device.info.live && !strcmp(device.info.mode, "DDP") &&
      (WLEDNetwork.localIP().toString() == device.info.source || (apActive && WiFi.softAPIP().toString() == device.info.source));
    root["on"] = device.info.on; root["brightness"] = device.info.brightness;
    root["override"] = device.info.liveOverride; root["configKnown"] = device.info.configKnown;
    root["mainSegmentOnly"] = device.info.mainSegmentOnly; root["respectMaps"] = device.info.respectMaps;
    root["sequenceSkip"] = device.info.sequenceSkip; root["offset"] = device.info.offset;
    root["dmxAddress"] = device.info.dmxAddress; root["maxBrightness"] = device.info.maxBrightness;
    root["outputsImportable"] = device.info.outputsImportable; root["outputsTruncated"] = device.info.outputsTruncated;
    JsonArray outputs = root.createNestedArray("outputs");
    for (size_t j = 0; j < device.info.outputCount; j++) {
      const RemoteOutput& output = device.info.outputs[j];
      JsonObject value = outputs.createNestedObject();
      value["start"] = output.start; value["count"] = output.count; value["type"] = output.type; value["reverse"] = output.reverse;
    }
    if (document.overflowed()) { delete response; return false; }
    if (comma) response->print(',');
    serializeJson(root, *response); comma = true;
  }
  response->print(F("]}")); request->send(response);
  return true;
}
} // namespace ledwall
// AI: end
#endif

#include "wled.h"
#include "spatial_model.h"
#include "spatial_json.h"
#include "storage.h"
#include "web_ui.h"
#include "remote_network.h"
#include <algorithm>
#include <atomic>
#include <new>
#include <cerrno>
#ifdef ARDUINO_ARCH_ESP32
#include <esp_system.h>
#endif

#ifdef ARDUINO_ARCH_ESP32

// AI: below section was generated by an AI
namespace {

constexpr size_t MAX_REQUEST_BYTES = 16384;

// Preserve the parser's position so a second JSON value or trailing junk is rejected.
class BoundedJsonInput {
  const uint8_t* _bytes;
  size_t _length, _position = 0;
public:
  BoundedJsonInput(const uint8_t* bytes, size_t length) : _bytes(bytes), _length(length) {}
  int read() { return _position < _length ? _bytes[_position++] : -1; }
  size_t readBytes(char* output, size_t requested) {
    const size_t count = std::min(requested, _length - _position);
    memcpy(output, _bytes + _position, count);
    _position += count;
    return count;
  }
  bool whitespaceRemaining() {
    int value;
    while ((value = read()) >= 0) if (value != ' ' && value != '\t' && value != '\r' && value != '\n') return false;
    return true;
  }
};

// Responses own their JSON text so no asynchronous response retains the shared document.
static void sendError(AsyncWebServerRequest* request, int status, const char* error) {
  StaticJsonDocument<192> document;
  document["error"] = error;
  AsyncResponseStream* response = request->beginResponseStream(FPSTR(CONTENT_TYPE_JSON));
  if (!response) { request->send(503); return; }
  response->setCode(status);
  response->addHeader(F("Cache-Control"), F("no-store"));
  serializeJson(document, *response);
  request->send(response);
}

// Each request owns its fragment accounting; the server frees _tempObject on disconnect.
class LedwallJsonHandler : public AsyncWebHandler {
  struct Body {
    size_t total, received;
    bool invalid;
  };
  std::function<void(AsyncWebServerRequest*, const uint8_t*, size_t)> _callback;

public:
  explicit LedwallJsonHandler(std::function<void(AsyncWebServerRequest*, const uint8_t*, size_t)> callback)
    : _callback(callback) {}

  bool canHandle(AsyncWebServerRequest* request) override {
    return request->method() == HTTP_POST && request->url() == F("/json/ledwall");
  }

  // Fragment offsets are checked before copying, including premature/out-of-order bodies.
  void handleBody(AsyncWebServerRequest* request, uint8_t* data, size_t len, size_t index, size_t total) override {
    if (total == 0 || total > MAX_REQUEST_BYTES) return;
    if (index == 0 && !request->_tempObject) {
      Body* body = static_cast<Body*>(malloc(sizeof(Body) + total));
      if (!body) return;
      body->total = total;
      body->received = 0;
      body->invalid = false;
      request->_tempObject = body;
    }
    Body* body = static_cast<Body*>(request->_tempObject);
    if (!body) return;
    if (body->invalid || total != body->total || index != body->received || index > total || len > total - index) {
      body->invalid = true;
      return;
    }
    memcpy(reinterpret_cast<uint8_t*>(body + 1) + index, data, len);
    body->received += len;
  }

  void handleRequest(AsyncWebServerRequest* request) override {
    if (request->contentLength() > MAX_REQUEST_BYTES) { sendError(request, 413, "body_too_large"); return; }
    Body* body = static_cast<Body*>(request->_tempObject);
    if (!body || body->invalid || body->received != body->total || body->total != request->contentLength()) {
      sendError(request, 400, "body_incomplete");
      return;
    }
    _callback(request, reinterpret_cast<const uint8_t*>(body + 1), body->total);
  }

  bool isRequestHandlerTrivial() override { return false; }
};

class LedwallUsermod : public Usermod {
  struct Command {
    ledwall::Config config;
    uint32_t revision;
    bool persist;
  };

  ledwall::Config _active = ledwall::defaultConfig();
  SemaphoreHandle_t _configMutex = nullptr;
  Command* _pending = nullptr;
  uint32_t _nextRevision = 0;
  uint8_t* _frame = nullptr;
  size_t _capacity = 0;
  uint32_t _lastMillis = 0, _nextFrameUs = 0;
  uint64_t _animationMs = 0;
  std::atomic<bool> _processing{false}, _ota{false};
  std::atomic<uint32_t> _revision{0}, _savedRevision{0}, _failedRevision{0};
  std::atomic<uint32_t> _frames{0}, _sendErrors{0}, _lastFrameUs{0};
  std::atomic<const char*> _lastError{""};
  std::atomic<uint32_t> _loopAt{0}, _loopStackFree{0};
  std::atomic<uint32_t> _attempts[ledwall::MAX_CONTROLLERS]{}, _outputErrors[ledwall::MAX_CONTROLLERS]{};
  std::atomic<int> _lastSendErrno[ledwall::MAX_CONTROLLERS]{};
  std::atomic<uint8_t> _lastSendResult[ledwall::MAX_CONTROLLERS]{};
  uint32_t _lastDiagnosticMs = 0;
  ledwall::RemoteNetwork _network;

  // Caller holds the config mutex; counters and worker breadcrumbs are independently atomic.
  void writeDiagnostics(JsonObject status) const {
    status["build"] = "ledwall-diag-20261101-1";
    status["revision"] = _revision.load();
    status["savedRevision"] = _savedRevision.load();
    status["failedRevision"] = _failedRevision.load();
    status["pending"] = _pending != nullptr || _processing.load();
    status["frames"] = _frames.load();
    status["sendErrors"] = _sendErrors.load();
    status["lastFrameUs"] = _lastFrameUs.load();
    status["pausedForOta"] = _ota.load();
    status["enabled"] = _active.enabled;
    status["brightness"] = _active.brightness;
    size_t mappedLeds = 0;
    for (size_t i = 0; i < _active.stripCount; i++) mappedLeds += _active.strips[i].count;
    status["mappedLeds"] = mappedLeds;
    status["uptimeMs"] = millis();
    status["resetReason"] = unsigned(esp_reset_reason());
    status["wifiStatus"] = int(WiFi.status());
    status["ip"] = WLEDNetwork.localIP().toString();
    status["subnetMask"] = WLEDNetwork.subnetMask().toString();
    status["gateway"] = WLEDNetwork.gatewayIP().toString();
    status["wifiSleep"] = bool(WiFi.getSleep());
    status["rssi"] = WiFi.RSSI();
    status["heap"] = getFreeHeapSize();
    status["minimumHeap"] = ESP.getMinFreeHeap();
    status["largestBlock"] = getContiguousFreeHeap();
    status["loopAgeMs"] = millis() - _loopAt.load();
    status["loopStackMinimumFreeBytes"] = _loopStackFree.load();
    status["lastError"] = _lastError.load();
    _network.diagnostics(status.createNestedObject("network"));
    JsonArray outputs = status.createNestedArray("outputs");
    for (size_t i = 0; i < _active.controllerCount; i++) {
      const auto& controller = _active.controllers[i];
      JsonObject output = outputs.createNestedObject();
      output["id"] = controller.id;
      output["ip"] = IPAddress(controller.ip[0],controller.ip[1],controller.ip[2],controller.ip[3]).toString();
      output["attempts"] = _attempts[i].load();
      output["sendErrors"] = _outputErrors[i].load();
      output["lastResult"] = _lastSendResult[i].load();
      // Native realtimeBroadcast only returns success/failure; errno may be altered during socket cleanup.
      output["errnoAfterSend"] = _lastSendErrno[i].load();
    }
  }

  // Rate-limit diagnostic serial output so a failing destination cannot flood the render loop.
  void logDiagnostics() {
    if (millis() - _lastDiagnosticMs < 5000) return;
    _lastDiagnosticMs = millis();
    _loopStackFree.store(uxTaskGetStackHighWaterMark(nullptr));
    #ifdef WLED_DEBUG
    DEBUG_PRINTF_P(PSTR("[LEDWALL] up=%lu reset=%u wifi=%d rssi=%d sleep=%u heap=%u min=%u block=%u loopStack=%lu netAge=%lu netStack=%lu frames=%lu errors=%lu\n"),
      millis(), unsigned(esp_reset_reason()), int(WiFi.status()), WiFi.RSSI(), unsigned(WiFi.getSleep()),
      getFreeHeapSize(), ESP.getMinFreeHeap(), getContiguousFreeHeap(), _loopStackFree.load(),
      _network.heartbeatAge(), _network.stackFree(), _frames.load(), _sendErrors.load());
    for (size_t i = 0; i < _active.controllerCount; i++) {
      const auto& controller = _active.controllers[i];
      DEBUG_PRINTF_P(PSTR("[LEDWALL] dst=%u.%u.%u.%u attempts=%lu errors=%lu result=%u errnoAfterSend=%d\n"),
        controller.ip[0],controller.ip[1],controller.ip[2],controller.ip[3],_attempts[i].load(),
        _outputErrors[i].load(),unsigned(_lastSendResult[i].load()),_lastSendErrno[i].load());
    }
    #endif
  }

  // PIN-only requests unlock the existing WLED policy before a configuration is downloaded.
  bool authorize(AsyncWebServerRequest* request, JsonObjectConst root) {
    if (root.containsKey("pin")) {
      if (!root["pin"].is<const char*>() || strnlen(root["pin"].as<const char*>(), 5) != 4) {
        sendError(request, 400, "pin_invalid");
        return false;
      }
      checkSettingsPIN(root["pin"].as<const char*>());
    }
    if (!correctPIN && settingsPIN[0]) { sendError(request, 401, "pin_required"); return false; }
    return true;
  }

  // Copy configuration into an owned response while holding only a short read lock.
  void serveSnapshot(AsyncWebServerRequest* request) {
    if (!correctPIN && settingsPIN[0]) { sendError(request, 401, "pin_required"); return; }
    if (!_configMutex) { sendError(request, 503, "module_unavailable"); return; }
    JSONBufferGuard documentGuard;
    if (!documentGuard) { sendError(request, 503, "json_busy"); return; }
    if (xSemaphoreTake(_configMutex, pdMS_TO_TICKS(10)) != pdTRUE) { sendError(request, 503, "config_busy"); return; }
    JsonObject root = pDoc->to<JsonObject>();
    const bool written = ledwall::writeConfig(root.createNestedObject("config"), _active);
    JsonObject status = root.createNestedObject("status");
    writeDiagnostics(status);
    xSemaphoreGive(_configMutex);
    if (!written || pDoc->overflowed()) { sendError(request, 503, "json_capacity"); return; }
    AsyncResponseStream* response = request->beginResponseStream(FPSTR(CONTENT_TYPE_JSON));
    if (!response) { sendError(request, 503, "response_no_memory"); return; }
    response->addHeader(F("Cache-Control"), F("no-store"));
    serializeJson(root, *response);
    request->send(response);
  }

  // Validate a full snapshot before publishing one immutable command to the main loop.
  void acceptSnapshot(AsyncWebServerRequest* request, const uint8_t* bytes, size_t length) {
    if (!_configMutex) { sendError(request, 503, "module_unavailable"); return; }
    JSONBufferGuard documentGuard;
    if (!documentGuard) { sendError(request, 503, "json_busy"); return; }
    BoundedJsonInput input(bytes, length);
    const DeserializationError result = deserializeJson(*pDoc, input, DeserializationOption::NestingLimit(8));
    JsonObjectConst root = pDoc->as<JsonObjectConst>();
    if (result || root.isNull() || !input.whitespaceRemaining()) { sendError(request, 400, "json_invalid"); return; }
    if (!authorize(request, root)) return;
    if (root.containsKey("action")) {
      if (!root["action"].is<const char*>() || root.containsKey("config")) { sendError(request, 400, "action_invalid"); return; }
      const char* action = root["action"];
      bool accepted = false;
      if (!strcmp(action, "scan")) accepted = _network.requestScan();
      else if ((!strcmp(action, "probe") || !strcmp(action, "prepare")) && root["ip"].is<const char*>()) {
        if (!strcmp(action, "probe")) accepted = _network.requestProbe(root["ip"]);
        else {
          if (root.containsKey("receiverPin") && !root["receiverPin"].is<const char*>()) { sendError(request, 400, "receiver_pin_invalid"); return; }
          accepted = _network.requestPrepare(root["ip"], root["receiverPin"] | "");
        }
      } else { sendError(request, 400, "action_invalid"); return; }
      if (!accepted) { sendError(request, 400, "network_action_unavailable_or_address_invalid"); return; }
      request->send(202, FPSTR(CONTENT_TYPE_JSON), F("{\"queued\":true}"));
      return;
    }
    if (!root.containsKey("config")) {
      if (!root.containsKey("pin")) { sendError(request, 400, "config_required"); return; }
      request->send(200, FPSTR(CONTENT_TYPE_JSON), F("{\"success\":true}"));
      return;
    }
    if (root.containsKey("persist") && !root["persist"].is<bool>()) { sendError(request, 400, "persist_invalid"); return; }
    Command* command = static_cast<Command*>(d_malloc(sizeof(Command)));
    if (!command) { sendError(request, 503, "config_no_memory"); return; }
    new (command) Command;
    const char* error = nullptr;
    if (!ledwall::parseConfig(root["config"], command->config, error)) {
      command->~Command();
      d_free(command);
      sendError(request, 400, error ? error : "config_invalid");
      return;
    }
    command->persist = root["persist"] | false;
    if (xSemaphoreTake(_configMutex, pdMS_TO_TICKS(10)) != pdTRUE) {
      command->~Command(); d_free(command); sendError(request, 503, "config_busy"); return;
    }
    if (_pending || _processing.load() || _nextRevision == UINT32_MAX) {
      xSemaphoreGive(_configMutex);
      command->~Command(); d_free(command); sendError(request, 409, "update_pending"); return;
    }
    command->revision = ++_nextRevision;
    const uint32_t acceptedRevision = command->revision;
    _pending = command;
    xSemaphoreGive(_configMutex);
    StaticJsonDocument<64> responseDocument;
    responseDocument["revision"] = acceptedRevision;
    AsyncResponseStream* response = request->beginResponseStream(FPSTR(CONTENT_TYPE_JSON));
    if (!response) { request->send(202); return; }
    response->setCode(202);
    response->addHeader(F("Cache-Control"), F("no-store"));
    serializeJson(responseDocument, *response);
    request->send(response);
  }

  // Allocation succeeds before the live configuration or its framebuffer is replaced.
  void applyPending() {
    if (xSemaphoreTake(_configMutex, 0) != pdTRUE) return;
    Command* command = _pending;
    if (command) { _pending = nullptr; _processing.store(true); }
    xSemaphoreGive(_configMutex);
    if (!command) return;
    const size_t required = command->config.enabled ? ledwall::frameBytes(command->config) : 0;
    uint8_t* replacement = required ? static_cast<uint8_t*>(d_malloc(required)) : nullptr;
    if (required && !replacement) {
      _failedRevision.store(command->revision);
      _lastError.store("frame_no_memory");
    } else if (xSemaphoreTake(_configMutex, pdMS_TO_TICKS(10)) != pdTRUE) {
      if (replacement) d_free(replacement);
      _failedRevision.store(command->revision);
      _lastError.store("config_busy");
    } else {
      uint8_t* previous = _frame;
      _frame = replacement;
      _capacity = required;
      _active = command->config;
      for (size_t i = 0; i < ledwall::MAX_CONTROLLERS; i++) {
        _attempts[i].store(0); _outputErrors[i].store(0); _lastSendResult[i].store(0); _lastSendErrno[i].store(0);
      }
      _revision.store(command->revision);
      _lastError.store("");
      xSemaphoreGive(_configMutex);
      if (previous) d_free(previous);
      _nextFrameUs = micros();
      if (command->persist) {
        const char* error = nullptr;
        if (ledwall::storage::save(_active, command->revision, error)) _savedRevision.store(command->revision);
        else { _failedRevision.store(command->revision); _lastError.store(error ? error : "storage_failed"); }
      }
    }
    command->~Command();
    d_free(command);
    _processing.store(false);
  }

public:
  // Register routes before WLED's generic /json handler and load only validated saved state.
  void setup() override {
    _configMutex = xSemaphoreCreateMutex();
    if (!_configMutex) { _lastError.store("mutex_no_memory"); return; }
    bool recovered = false;
    const char* error = nullptr;
    uint32_t loadedRevision = 0;
    if (ledwall::storage::load(_active, loadedRevision, recovered, error)) {
      _capacity = _active.enabled ? ledwall::frameBytes(_active) : 0;
      _frame = _capacity ? static_cast<uint8_t*>(d_malloc(_capacity)) : nullptr;
      if (_capacity && !_frame) {
        _active.enabled = false;
        _capacity = 0;
        _lastError.store("frame_no_memory");
      } else {
        _revision.store(loadedRevision);
        _savedRevision.store(loadedRevision);
        if (recovered) _lastError.store("recovered_backup");
      }
      _nextRevision = loadedRevision;
    } else if (error) _lastError.store(error);
    _lastMillis = millis();
    _nextFrameUs = micros();
    _network.begin();
    server.on(F("/ledwall"), HTTP_GET, [](AsyncWebServerRequest* request) {
      request->send_P(200, "text/html", LEDWALL_PAGE);
    }).setFilter([](AsyncWebServerRequest* request) { return request->url() == F("/ledwall"); });
    // AsyncWebServer also matches child paths by default; keep the snapshot from consuming /devices.
    server.on(F("/json/ledwall"), HTTP_GET, [this](AsyncWebServerRequest* request) { serveSnapshot(request); })
      .setFilter([](AsyncWebServerRequest* request) { return request->url() == F("/json/ledwall"); });
    server.on(F("/json/ledwall/devices"), HTTP_GET, [this](AsyncWebServerRequest* request) {
      if (!correctPIN && settingsPIN[0]) { sendError(request, 401, "pin_required"); return; }
      if (!_network.serve(request)) sendError(request, 503, "network_status_busy");
    }).setFilter([](AsyncWebServerRequest* request) { return request->url() == F("/json/ledwall/devices"); });
    LedwallJsonHandler* handler = new (std::nothrow) LedwallJsonHandler(
      [this](AsyncWebServerRequest* request, const uint8_t* bytes, size_t length) { acceptSnapshot(request, bytes, length); });
    if (handler) server.addHandler(handler);
    else _lastError.store("handler_no_memory");
  }

  // One timestamp drives every destination; late frames are skipped rather than queued.
  void loop() override {
    _loopAt.store(millis());
    const uint32_t nowMillis = millis();
    _animationMs += static_cast<uint32_t>(nowMillis - _lastMillis);
    _lastMillis = nowMillis;
    if (!_configMutex || _ota.load()) return;
    applyPending();
    logDiagnostics();
    _network.sync(_active);
    if (!_active.enabled || !_frame) return;
    const uint32_t nowUs = micros();
    if (static_cast<int32_t>(nowUs - _nextFrameUs) < 0) return;
    const uint32_t periodUs = 1000000UL / _active.fps;
    _nextFrameUs = nowUs - _nextFrameUs > periodUs ? nowUs + periodUs : _nextFrameUs + periodUs;
    const uint32_t started = micros();
    if (!ledwall::renderFrame(_active, _animationMs, _frame, _capacity)) {
      _lastError.store("render_failed");
      return;
    }
    for (size_t i = 0; i < _active.controllerCount; i++) {
      const ledwall::Controller& controller = _active.controllers[i];
      const IPAddress address(controller.ip[0], controller.ip[1], controller.ip[2], controller.ip[3]);
      errno = 0;
      const uint8_t result = realtimeBroadcast(0, address, controller.leds, _frame + ledwall::controllerOffset(_active, i), _active.brightness, false);
      const int systemError = errno;
      _attempts[i].fetch_add(1);
      _lastSendResult[i].store(result);
      _lastSendErrno[i].store(result ? systemError : 0);
      if (result) {
        _outputErrors[i].fetch_add(1);
        _sendErrors.fetch_add(1);
        _lastError.store("send_failed");
      }
    }
    _frames.fetch_add(1);
    _lastFrameUs.store(micros() - started);
  }

  void onUpdateBegin(bool begin) override { _ota.store(begin); _network.pause(begin); }

  // Native /json/info and USB {"v":true} expose identical evidence when HTTP is unavailable.
  void addToJsonInfo(JsonObject& root) override {
    if (!_configMutex || xSemaphoreTake(_configMutex, pdMS_TO_TICKS(10)) != pdTRUE) return;
    writeDiagnostics(root.createNestedObject("ledwall"));
    xSemaphoreGive(_configMutex);
  }
};

static LedwallUsermod ledwallUsermod;
REGISTER_USERMOD(ledwallUsermod);

} // namespace
// AI: end

#endif // ARDUINO_ARCH_ESP32

#include "wled.h"
#include "storage.h"
#include "spatial_json.h"
#include <new>

// AI: below section was generated by an AI
namespace ledwall {
namespace storage {

static constexpr size_t MAX_FILE_BYTES = 16384;
static const char PRIMARY_PATH[] PROGMEM = "/ledwall.json";
static const char BACKUP_PATH[] PROGMEM = "/ledwall.bak";
static const char TEMP_PATH[] PROGMEM = "/ledwall.tmp";

// The caller owns WLED's JSON buffer lock throughout the filesystem transaction.
static bool readPath(const char* path, Config& config, uint32_t& revision, const char*& error) {
  File file = WLED_FS.open(path, "r");
  if (!file) { error = "storage_open_failed"; return false; }
  if (file.size() == 0 || file.size() > MAX_FILE_BYTES) {
    file.close();
    error = "storage_size_invalid";
    return false;
  }
  pDoc->clear();
  const DeserializationError result = deserializeJson(*pDoc, file, DeserializationOption::NestingLimit(8));
  bool trailingValid = true;
  while (file.available()) {
    const int value = file.read();
    if (value != ' ' && value != '\t' && value != '\r' && value != '\n') { trailingValid = false; break; }
  }
  file.close();
  if (result || !trailingValid) { error = "storage_json_invalid"; return false; }
  JsonObjectConst root = pDoc->as<JsonObjectConst>();
  if (!root["revision"].is<uint32_t>() || root["revision"].as<uint32_t>() == 0) {
    error = "storage_revision_invalid";
    return false;
  }
  if (!parseConfig(root["config"], config, error)) return false;
  revision = root["revision"].as<uint32_t>();
  return true;
}

// An invalid primary never enables output; recovery requires a separately validated backup.
bool load(Config& config, uint32_t& revision, bool& recovered, const char*& error) {
  recovered = false;
  error = nullptr;
  const bool primaryExists = WLED_FS.exists(FPSTR(PRIMARY_PATH));
  const bool backupExists = WLED_FS.exists(FPSTR(BACKUP_PATH));
  if (!primaryExists && !backupExists) return false;
  JSONBufferGuard guard;
  if (!guard) { error = "json_busy"; return false; }
  if (primaryExists && readPath(PRIMARY_PATH, config, revision, error)) { error = nullptr; return true; }
  if (backupExists && readPath(BACKUP_PATH, config, revision, error)) {
    recovered = true;
    error = nullptr;
    return true;
  }
  return false;
}

// Filesystem writes occur only on explicit Save, in the main loop, outside the render path.
bool save(const Config& config, uint32_t revision, const char*& error) {
  error = nullptr;
  JSONBufferGuard guard;
  if (!guard) { error = "json_busy"; return false; }
  Config* verification = static_cast<Config*>(d_malloc(sizeof(Config)));
  if (!verification) { error = "storage_no_memory"; return false; }
  new (verification) Config;
  JsonObject root = pDoc->to<JsonObject>();
  root["revision"] = revision;
  if (!writeConfig(root.createNestedObject("config"), config) || pDoc->overflowed()) {
    d_free(verification);
    error = "storage_json_capacity";
    return false;
  }
  const size_t expected = measureJson(root);
  if (expected > MAX_FILE_BYTES) {
    d_free(verification);
    error = "storage_size_invalid";
    return false;
  }
  File file = WLED_FS.open(FPSTR(TEMP_PATH), "w");
  if (!file) { d_free(verification); error = "storage_open_failed"; return false; }
  const size_t written = serializeJson(root, file);
  file.flush();
  file.close();
  uint32_t verifiedRevision = 0;
  if (written != expected || !readPath(TEMP_PATH, *verification, verifiedRevision, error) || verifiedRevision != revision) {
    d_free(verification);
    if (!error) error = "storage_write_failed";
    return false;
  }

  bool rotated = false;
  if (WLED_FS.exists(FPSTR(PRIMARY_PATH))) {
    uint32_t previousRevision = 0;
    const char* previousError = nullptr;
    if (readPath(PRIMARY_PATH, *verification, previousRevision, previousError)) {
      if (WLED_FS.exists(FPSTR(BACKUP_PATH)) && !WLED_FS.remove(FPSTR(BACKUP_PATH))) {
        d_free(verification); error = "storage_backup_failed"; return false;
      }
      if (!WLED_FS.rename(PRIMARY_PATH, BACKUP_PATH)) {
        d_free(verification); error = "storage_backup_failed"; return false;
      }
      rotated = true;
    } else if (!WLED_FS.remove(FPSTR(PRIMARY_PATH))) {
      d_free(verification); error = "storage_replace_failed"; return false;
    }
  }
  d_free(verification);
  if (!WLED_FS.rename(TEMP_PATH, PRIMARY_PATH)) {
    if (rotated) WLED_FS.rename(BACKUP_PATH, PRIMARY_PATH);
    error = "storage_replace_failed";
    return false;
  }
  return true;
}

} // namespace storage
} // namespace ledwall
// AI: end

#pragma once

// AI: below section was generated by an AI
static const char LEDWALL_PAGE[] PROGMEM = R"LEDWALL(<!doctype html>
<html lang="en">
<head>
	<meta charset="utf-8">
	<meta name="viewport" content="width=device-width,initial-scale=1">
	<meta name="color-scheme" content="dark">
	<title>LED Wall · WLED</title>
	<script>window.__noDevBanner = true;</script>
	<script src="/common.js"></script>
	<style>
		:root{font-family:system-ui,-apple-system,BlinkMacSystemFont,"Segoe UI",sans-serif;color:#e9edf4;background:#101318;--line:#303640;--muted:#9ca7b6;--accent:#a9ebce}
		*{box-sizing:border-box}body{margin:0}button,input,select{font:inherit}button,input,select{border:1px solid var(--line);border-radius:8px;background:#181d25;color:inherit;padding:9px 11px;min-height:40px}button{cursor:pointer;font-weight:600}button:hover{border-color:#91a2b9}button:disabled{opacity:.45;cursor:default}button.primary{background:var(--accent);border-color:var(--accent);color:#15251e}button.danger{color:#ffb7b7}input,select{width:100%;min-width:0}input[type=checkbox]{width:19px;min-height:19px;accent-color:var(--accent)}input:focus,select:focus,button:focus-visible{outline:2px solid var(--accent);outline-offset:2px}a{color:var(--accent);text-decoration:none}a:hover{text-decoration:underline}
		.shell{max-width:1480px;margin:auto;padding:26px 30px 40px}.topbar,.row,.section-title,.toolbar{display:flex;align-items:center;gap:12px}.topbar{justify-content:space-between;flex-wrap:wrap;margin-bottom:26px}.brand{display:flex;gap:13px;align-items:center}.mark{width:38px;height:38px;border-radius:11px;background:linear-gradient(145deg,#a9ebce,#8797ff);display:grid;place-items:center;color:#15251e;font-size:22px;font-weight:800}.eyebrow{font-size:11px;letter-spacing:.15em;text-transform:uppercase;color:var(--muted);font-weight:700}h1{font-size:25px;letter-spacing:-.04em;margin:2px 0 0}h2{font-size:15px;margin:0;letter-spacing:-.01em}h3{font-size:13px;margin:0}p{margin:7px 0;font-size:13px;line-height:1.55;color:var(--muted)}.toolbar{flex-wrap:wrap}.toolbar button{font-size:13px}.pill{font-size:11px;border:1px solid var(--line);border-radius:20px;padding:5px 9px;color:var(--muted)}.stats{display:grid;grid-template-columns:repeat(4,1fr);gap:12px;margin-bottom:18px}.stat{border:1px solid var(--line);background:#171b22;border-radius:12px;padding:14px 17px}.stat strong{font-size:23px;font-weight:600;letter-spacing:-.04em;display:block;margin-top:3px}.stat span{font-size:11px;text-transform:uppercase;letter-spacing:.08em;color:var(--muted)}.layout{display:grid;grid-template-columns:minmax(0,1fr) 310px;gap:18px;align-items:start}.stack{display:grid;gap:18px}.card{border:1px solid var(--line);background:#171b22;border-radius:13px;overflow:hidden}.card-head{padding:17px 19px;border-bottom:1px solid var(--line)}.section-title{justify-content:space-between}.card-body{padding:18px 19px}.canvas-head{display:flex;justify-content:space-between;align-items:center;gap:15px;flex-wrap:wrap}.canvas-wrap{height:clamp(280px,34vw,460px);background:#11151b;position:relative}canvas{display:block;width:100%;height:100%;touch-action:none;cursor:crosshair}.canvas-foot{padding:10px 19px;border-top:1px solid var(--line);display:flex;justify-content:space-between;gap:12px;font-size:11px;color:var(--muted);flex-wrap:wrap}.legend{display:flex;gap:7px;align-items:center}.dot{width:7px;height:7px;background:var(--accent);border-radius:50%}.fields{display:grid;grid-template-columns:1fr 1fr;gap:12px}.field{display:flex;flex-direction:column;gap:6px;font-size:11px;color:var(--muted)}.field.full{grid-column:1/-1}.check{display:flex;align-items:center;gap:9px;font-size:12px;color:var(--muted);min-height:30px}.small-button{font-size:12px;padding:7px 10px;min-height:34px}.device-list,.strip-list{display:grid;gap:10px}.device{padding:12px;background:#11161d;border:1px solid var(--line);border-radius:9px}.device .fields{grid-template-columns:62px minmax(90px,1fr) 70px;gap:8px;margin-top:10px}.device input{padding:7px;font-size:12px}.strip-item{display:flex;align-items:center;justify-content:space-between;gap:10px;width:100%;text-align:left;background:#11161d;padding:11px 12px}.strip-item[aria-pressed=true]{border-color:var(--accent);background:#192a26}.strip-item small{display:block;color:var(--muted);font-size:11px;font-weight:400;margin-top:4px}.swatch{height:25px;width:4px;border-radius:3px;background:var(--accent);flex:none}.strip-label{flex:1}.muted{color:var(--muted)}.empty{border:1px dashed var(--line);border-radius:8px;padding:15px;color:var(--muted);font-size:12px}.notice{padding:12px 15px;border:1px solid var(--line);border-radius:9px;font-size:12px;line-height:1.5;margin-top:16px;background:#171b22;color:var(--muted);white-space:pre-wrap}.notice.error{border-color:#795153;color:#ffb7b7}.notice.ok{border-color:#446b5c;color:var(--accent)}.below{display:grid;grid-template-columns:1fr 1fr;gap:18px}.divider{height:1px;background:var(--line);margin:17px 0}.status-lines{font-size:11px;color:var(--muted);line-height:1.8;white-space:pre-wrap}.pin{max-width:140px;font-size:12px}.hidden{display:none!important}.footnote{font-size:11px;color:var(--muted);margin-top:18px}.hint{font-size:11px;line-height:1.5;color:var(--muted)}
		@media(max-width:1050px){.layout{grid-template-columns:minmax(0,1fr) 280px}.below{grid-template-columns:1fr}.shell{padding:22px 20px}}@media(max-width:760px){.layout{grid-template-columns:1fr}.stats{grid-template-columns:1fr 1fr}.shell{padding:18px 14px 30px}.topbar{margin-bottom:18px}.toolbar{gap:7px}.toolbar button{padding:8px 10px}.stat{padding:12px 14px}.canvas-wrap{height:290px}.below{grid-template-columns:1fr}.card-head,.card-body{padding:15px}.canvas-foot{padding:10px 15px}.pin{max-width:115px}}
	</style>
</head>
<body>
	<main class="shell">
		<header class="topbar">
			<div class="brand"><div class="mark" aria-hidden="true">✦</div><div><div class="eyebrow">WLED / Spatial engine</div><h1>LED Wall</h1></div></div>
			<div class="toolbar"><a href="/">WLED</a><button id="reload">Reload</button><button id="apply">Apply</button><button id="save" class="primary">Save to master</button></div>
		</header>
		<div class="stats">
			<div class="stat"><span>Virtual wall</span><strong id="wallMetric">7 × 3 m</strong></div>
			<div class="stat"><span>Physical LEDs</span><strong id="ledMetric">0</strong></div>
			<div class="stat"><span>Controllers</span><strong id="controllerMetric">0</strong></div>
			<div class="stat"><span>Target frame rate</span><strong id="fpsMetric">30 FPS</strong></div>
		</div>
		<div class="layout">
			<div class="stack">
				<section class="card">
					<div class="card-head canvas-head"><div><h2>Spatial layout</h2><p>One shared effect. Every LED has a place.</p></div><label class="check"><input id="preview" type="checkbox" checked>Animate preview</label></div>
					<div class="canvas-wrap"><canvas id="wall" aria-label="Virtual LED wall. Select and drag strips, or drag their endpoint handles. Numeric controls below provide the same editing operations." tabindex="0"></canvas></div>
					<div class="canvas-foot"><span>Drag a strip to move it · drag its handles to rotate or resize</span><span class="legend"><span class="dot"></span>Illustrative browser preview</span></div>
				</section>
				<div class="below">
					<section class="card"><div class="card-head section-title"><h2>Strips</h2><button id="addStrip" class="small-button">+ Add strip</button></div><div class="card-body strip-list" id="strips"></div></section>
					<section class="card"><div class="card-head section-title"><h2 id="selectionTitle">Selected strip</h2><button id="removeStrip" class="small-button danger">Remove</button></div><div class="card-body" id="inspector"></div></section>
				</div>
				<section class="card"><div class="card-head section-title"><h2>WLED devices on the network</h2><button id="scan" class="small-button">Discover / refresh</button></div><div class="card-body"><p id="discoveryStatus" class="hint">Waiting for discovery…</p><div class="row"><input id="probeIp" type="text" maxlength="15" placeholder="Receiver IPv4 address" aria-label="Receiver IPv4 address"><button id="probe" class="small-button">Check IP</button></div><div id="discovered" class="device-list" style="margin-top:12px"></div><p class="hint">Finds WLED announcements and mDNS on this local network (up to 16 cached devices). If a device does not appear, check its IP manually. Online means its WLED HTTP API answered; it does not confirm LED output.</p></div></section>
				<section class="card"><div class="card-head section-title"><h2>Remote controllers</h2><button id="addController" class="small-button">+ Add manually</button></div><div class="card-body"><div id="controllers" class="device-list"></div><p class="hint">Import outputs reads hardware outputs, not effect segments. Their position on the wall must be set here. Use DHCP reservations for stable addresses.</p><p class="hint">Prepare receiver saves global realtime addressing, disables packet sequence skipping, enables maximum realtime brightness and clears live override / ordinary Sync reception. Current limits and GPIO settings remain receiver settings. This action does not start the wall.</p></div></section>
			</div>
			<aside class="stack">
				<section class="card"><div class="card-head section-title"><h2>Effect</h2><span class="pill" id="outputState">Output unknown</span></div><div class="card-body"><div class="fields" id="effectFields"></div><div class="divider"></div><label class="check"><input id="enabled" type="checkbox">Enable DDP output on Apply / Save</label><button id="toggleOutput" class="primary" style="margin-top:12px">Start wall</button><p class="hint">Start wall applies this layout and enables DDP. Ordinary WLED Sync does not start the wall. Animate preview only affects this browser.</p></div></section>
				<section class="card"><div class="card-head"><h2>Canvas & output</h2></div><div class="card-body"><div class="fields" id="canvasFields"></div><div class="divider"></div><div class="row"><button id="export" class="small-button">Export JSON</button><button id="import" class="small-button">Import JSON</button><input id="importFile" type="file" accept="application/json,.json" class="hidden"></div><p class="hint">Dimensions and endpoints use centimetres. Canvas area does not allocate a full pixel grid.</p></div></section>
				<section class="card"><div class="card-head"><h2>Master status</h2></div><div class="card-body"><div id="runtime" class="status-lines">Connecting to the master…</div><div class="divider"></div><label class="field">WLED settings PIN, if configured<input id="pin" type="password" inputmode="numeric" autocomplete="off" maxlength="16" placeholder="Optional PIN"></label><button id="unlock" class="small-button" style="margin-top:10px">Unlock & load</button><p class="hint">Apply changes runtime settings. Save also writes the configuration to the master's filesystem. DDP transmission does not confirm remote delivery.</p></div></section>
			</aside>
		</div>
		<div id="notice" class="notice" role="status" aria-live="polite">Loading configuration…</div>
		<div class="footnote">LED Wall MVP · Sparse spatial rendering · RGB / DDP · Configuration version 1</div>
	</main>
	<script>
		// AI: below section was generated by an AI
		'use strict';
		const apiPath = '/json/ledwall';
		let config = {version:1,enabled:false,canvas:{width:700,height:300},fps:30,brightness:128,effect:{name:'rainbow',speed:0.1,wavelength:200,direction:0,centerX:350,centerY:150,seed:1},controllers:[],strips:[]};
		let selectedId = null, dirty = false, busy = false, polling = false, loaded = false, lastStatus = null, drag = null, view = null;
		let devices = [], devicePolling = false, networkBusy = false, networkReceived = 0;
		const canvas = gId('wall'), context = canvas.getContext('2d');
		const effectNames = ['rainbow','wave','ripple','noise'];
		const stripColors = ['#a9ebce','#bba8ff','#f4bf86','#8ecbff','#f29dc2','#d5dc8c'];

		// Build labels and controls without interpreting configuration strings as HTML.
		function field(parent, label, value, change, options = {}) {
			const wrapper = cE('label'); wrapper.className = 'field' + (options.full ? ' full' : '');
			const text = cE('span'); text.textContent = label; wrapper.append(text);
			const input = cE(options.choices ? 'select' : 'input');
			if (options.choices) for (const choice of options.choices) { const option = cE('option'); option.value = choice.value; option.textContent = choice.label; input.append(option); }
			else { input.type = options.type || 'number'; if (input.type === 'number') { input.step = options.step || 'any'; if (options.min !== undefined) input.min = options.min; if (options.max !== undefined) input.max = options.max; } }
			input.value = value; if (options.key) input.dataset.key = options.key;
			input.addEventListener('change', () => { const numeric = !options.choices && input.type !== 'text'; if (numeric && (input.value === '' || !input.checkValidity())) { notice('Enter a value within the displayed control\'s allowed range.','error'); return; } const next = numeric ? Number(input.value) : input.value; change(next); markDirty(); });
			wrapper.append(input); parent.append(wrapper); return input;
		}
		function notice(text, kind = '') { gId('notice').textContent = text; gId('notice').className = 'notice' + (kind ? ' ' + kind : ''); }
		function selectedStrip() { return config.strips.find(strip => strip.id === selectedId); }
		function markDirty() { dirty = true; updateMetrics(); notice('Unsaved layout changes. Apply to run them now, or Save to keep them after a restart.'); }
		function nextId(items) { let id = 1; while (items.some(item => item.id === id)) id++; return id; }

		// Rebuild the forms only after structural changes or a loaded snapshot.
		function renderForms() {
			gId('effectFields').replaceChildren(); gId('canvasFields').replaceChildren();
			const effect = gId('effectFields'), settings = gId('canvasFields');
			field(effect,'Pattern',config.effect.name,value => { config.effect.name = value; },{full:true,choices:effectNames.map(name => ({value:name,label:name.charAt(0).toUpperCase()+name.slice(1)+' 2D'}))});
			field(effect,'Speed (cycles/s)',config.effect.speed,value => { config.effect.speed = value; },{min:-10,max:10,step:0.01});
			field(effect,'Wavelength (cm)',config.effect.wavelength,value => { config.effect.wavelength = value; },{min:0.01,max:100000});
			field(effect,'Direction (degrees)',config.effect.direction,value => { config.effect.direction = value; },{min:-360,max:360});
			field(effect,'Brightness (0–255)',config.brightness,value => { config.brightness = value; },{min:0,max:255,step:1});
			field(effect,'Ripple centre X',config.effect.centerX,value => { config.effect.centerX = value; },{min:0,max:config.canvas.width});
			field(effect,'Ripple centre Y',config.effect.centerY,value => { config.effect.centerY = value; },{min:0,max:config.canvas.height});
			field(effect,'Noise seed',config.effect.seed,value => { config.effect.seed = value; },{min:0,max:4294967295,step:1,full:true});
			field(settings,'Width (cm)',config.canvas.width,value => { config.canvas.width = value; renderInspector(); },{min:0.01,max:100000});
			field(settings,'Height (cm)',config.canvas.height,value => { config.canvas.height = value; renderInspector(); },{min:0.01,max:100000});
			field(settings,'Target FPS',config.fps,value => { config.fps = value; },{min:1,max:60,step:1,full:true});
			gId('enabled').checked = config.enabled;
			renderControllers(); renderStrips(); renderInspector(); updateMetrics();
		}

		// Controller IDs remain stable references when the user renames an ID.
		function renderControllers() {
			const list = gId('controllers'); list.replaceChildren();
			for (const controller of config.controllers) {
				const card = cE('div'); card.className = 'device';
				const title = cE('div'); title.className = 'section-title'; const name = cE('h3'); name.textContent = 'Controller '+controller.id;
				const remove = cE('button'); remove.className = 'small-button danger'; remove.textContent = 'Remove';
				remove.addEventListener('click', () => { if (config.strips.some(strip => strip.controller === controller.id)) { notice('Remove or reassign this controller\'s strips first.','error'); return; } config.controllers = config.controllers.filter(item => item !== controller); renderForms(); markDirty(); });
				title.append(name,remove); const inputs = cE('div'); inputs.className = 'fields';
				field(inputs,'ID',controller.id,value => { const oldId = controller.id; controller.id = value; for (const strip of config.strips) if (strip.controller === oldId) strip.controller = value; renderControllers(); renderInspector(); renderStrips(); },{min:1,max:65535,step:1});
				field(inputs,'IPv4 address',controller.ip,value => { controller.ip = value.trim(); renderControllers(); },{type:'text'});
				field(inputs,'LEDs',controller.leds,value => { controller.leds = value; renderStrips(); },{min:1,max:4096,step:1});
				const health = cE('p'); health.className = 'hint'; health.dataset.healthIp = controller.ip;
				const actions = cE('div'); actions.className = 'row'; actions.style.flexWrap = 'wrap';
				for (const [label,action] of [['Check now','probe'],['Import outputs','import'],['Prepare receiver','prepare']]) {
					const button = cE('button'); button.className = 'small-button'; button.textContent = label;
					button.addEventListener('click', () => action === 'import' ? importRemote(controller.ip,controller.id) : networkAction(action,controller.ip)); actions.append(button);
				}
				const pin = cE('input'); pin.type = 'password'; pin.inputMode = 'numeric'; pin.maxLength = 4; pin.autocomplete = 'off'; pin.placeholder = 'Receiver PIN (optional)'; pin.setAttribute('aria-label','Receiver '+controller.id+' settings PIN'); pin.dataset.receiverIp = controller.ip;
				const link = cE('a'); link.textContent = 'Open receiver'; link.href = /^\d{1,3}(\.\d{1,3}){3}$/.test(controller.ip) ? 'http://'+controller.ip+'/' : '#'; link.target = '_blank'; link.rel = 'noopener';
				card.append(title,inputs,health,actions,pin,link); list.append(card);
			}
			if (!config.controllers.length) { const empty = cE('div'); empty.className = 'empty'; empty.textContent = 'Add a controller, then assign strips to its physical LED ranges.'; list.append(empty); }
			gId('addController').disabled = !loaded || config.controllers.length >= 8;
			updateDeviceHealth();
			renderDiscoveredDevices();
		}

		// Import an inventory atomically; matching ranges keep their existing spatial placement.
		function layoutWithDevice(layout, device, controllerId = null) {
			if (!device || device.health !== 'online' || !device.configKnown || !device.outputsImportable || device.outputsTruncated || !Array.isArray(device.outputs) || !device.outputs.length) throw Error('A fresh, readable digital output inventory is required. Check the receiver first.');
			const next = JSON.parse(JSON.stringify(layout));
			let controller = controllerId === null ? next.controllers.find(item => item.ip === device.ip) : next.controllers.find(item => item.id === controllerId);
			if (!controller) { if (next.controllers.length >= 8) throw Error('Maximum: 8 controllers.'); controller = {id:nextId(next.controllers),ip:device.ip,leds:0}; next.controllers.push(controller); }
			const previous = next.strips.filter(strip => strip.controller === controller.id);
			next.strips = next.strips.filter(strip => strip.controller !== controller.id);
			controller.leds = Math.max(device.leds,...device.outputs.map(output => output.start+output.count));
			device.outputs.forEach((output,index) => {
				const match = previous.find(strip => strip.start === output.start && strip.count === output.count);
				const y = next.canvas.height*(index+1)/(device.outputs.length+1);
				next.strips.push(match || {id:nextId([...next.strips,...previous]),controller:controller.id,start:output.start,count:output.count,x1:next.canvas.width*0.1,y1:y,x2:next.canvas.width*0.9,y2:y,reverse:false});
			});
			return validateSnapshot(next);
		}
		function importRemote(ip, id = null) {
			try {
				if (Date.now()-networkReceived > 15000) throw Error('Network status is stale. Refresh before importing.');
				config = layoutWithDevice(config,devices.find(device => device.ip === ip),id); selectedId = config.strips.length ? config.strips[0].id : null;
				renderForms(); markDirty(); notice('Outputs imported into the local layout. Matching ranges kept their positions; new ranges need placement. Apply or Save to use them.','ok');
			} catch (error) { notice(error.message,'error'); }
		}
		// Keep HTTP availability separate from receiver-reported realtime mode and configuration.
		function deviceDiagnostics(device, controller, status) {
			if (!device) return 'Not checked. Choose Check now.';
			const lines = [device.health.toUpperCase()+' · '+(device.name || device.ip)+(device.ageMs >= 0 ? ' · checked '+Math.round(device.ageMs/1000)+' s ago' : '')];
			const output = status && Array.isArray(status.outputs) && status.outputs.find(item => item.ip === controller.ip);
			if (output) lines.push('Master send attempts: '+output.attempts+' · local send errors: '+output.sendErrors+' · last result: '+output.lastResult+' · errno after send: '+output.errnoAfterSend);
			if (device.health !== 'online') return lines.concat(device.error || 'No fresh WLED response.').join('\n');
			lines.push('Receiver: '+device.leds+' LEDs · '+(device.configKnown ? device.outputs.length+' hardware outputs' : 'output inventory unavailable'));
			if (controller.leds !== device.leds) lines.push('LED count differs: wall '+controller.leds+', receiver '+device.leds+'. Import outputs or adjust the layout.');
			if (device.override) lines.push('BLOCKED: receiver live override is enabled. Prepare receiver or clear override.');
			if (device.configKnown && (device.mainSegmentOnly || device.respectMaps || device.offset !== 0 || device.dmxAddress > 2 || device.sequenceSkip)) lines.push('Receiver addressing / sequence settings differ from the wall baseline. Prepare receiver or review Sync Interfaces.');
			if (!device.on && !device.maxBrightness) lines.push('Receiver is off; realtime brightness may prevent visible output.');
			if (device.receivingFromMaster) lines.push('Receiver reports DDP from this master. Physical LED output still requires verification.');
			else if (device.live) lines.push('Receiver reports '+(device.mode || 'realtime')+' from '+(device.source || 'unknown source')+'.');
			else if (status && status.enabled) lines.push('No realtime reception reported. Check destination IP, start wall, UDP 4048 and Wi-Fi isolation.');
			if (device.error) lines.push(device.error);
			return lines.join('\n');
		}
		function updateDeviceHealth() {
			for (const element of d.querySelectorAll('[data-health-ip]')) {
				const controller = config.controllers.find(item => item.ip === element.dataset.healthIp);
				if (controller) { element.style.whiteSpace = 'pre-line'; element.textContent = deviceDiagnostics(devices.find(item => item.ip === controller.ip),controller,lastStatus); }
			}
		}
		// Keep already configured receivers visible so an empty candidate list cannot hide successful discovery.
		function renderDiscoveredDevices() {
			const list = gId('discovered'); list.replaceChildren();
			for (const device of devices) {
				const added = config.controllers.some(controller => controller.ip === device.ip);
				const row = cE('div'); row.className = 'device'; const title = cE('p'); title.textContent = (device.name || 'WLED')+' · '+device.ip+' · '+device.health;
				const button = cE('button'); button.className = 'small-button'; button.textContent = added ? 'Already in wall' : 'Add with outputs';
				button.disabled = added || device.health !== 'online' || !device.configKnown || !device.outputsImportable;
				button.addEventListener('click',()=>importRemote(device.ip)); row.append(title,button); list.append(row);
			}
		}
		async function readDevices() {
			if (devicePolling) return;
			devicePolling = true;
			try {
				const response = await apiRequest({cache:'no-store'},apiPath+'/devices');
				if (!response.ok) throw Error('Network status unavailable ('+response.status+').');
				const data = await response.json(); if (!Array.isArray(data.devices)) throw Error('Invalid device list.');
				devices = data.devices; networkReceived = Date.now(); updateDeviceHealth();
				gId('discoveryStatus').textContent = !data.available ? 'Network worker unavailable. Check free memory and restart the master.' : (data.scanning ? 'Discovering WLED devices… ' : '')+devices.length+' cached devices. Background HTTP checks continue while this page is closed.';
				renderDiscoveredDevices();
			} catch (error) {
				devices = []; updateDeviceHealth(); gId('discovered').replaceChildren(); gId('discoveryStatus').textContent = error.message+' Previous network status is stale.';
			} finally { devicePolling = false; }
		}
		async function networkAction(action, ip = '') {
			if (networkBusy) return;
			networkBusy = true;
			try {
				const body = {action,ip}; if (gId('pin').value) body.pin = gId('pin').value;
				if (action === 'prepare') {
					const input = [...d.querySelectorAll('[data-receiver-ip]')].find(item => item.dataset.receiverIp === ip);
					body.receiverPin = input ? input.value : ''; if (input) input.value = '';
				}
				const response = await apiRequest({method:'POST',headers:{'Content-Type':'application/json'},body:JSON.stringify(body)});
				if (!response.ok) { const result = await response.json(); throw Error(result.error || 'Network action rejected.'); }
				notice(action === 'prepare' ? 'Receiver preparation queued. Review its diagnostics after the background check; then Start wall.' : 'Network check queued. Results appear after the background requests finish.');
				setTimeout(readDevices,2000);
			} catch (error) { notice(error.message,'error'); }
			finally { networkBusy = false; }
		}

		// The list identifies physical output ranges independently of spatial direction.
		function renderStrips() {
			const list = gId('strips'); list.replaceChildren();
			config.strips.forEach((strip,index) => {
				const item = cE('button'); item.className = 'strip-item'; item.setAttribute('aria-pressed',String(strip.id === selectedId));
				const swatch = cE('span'); swatch.className = 'swatch'; swatch.style.background = stripColors[index % stripColors.length];
				const label = cE('span'); label.className = 'strip-label'; label.textContent = 'Strip '+strip.id;
				const detail = cE('small'); detail.textContent = 'Controller '+strip.controller+' · LEDs '+strip.start+'–'+(strip.start+strip.count-1)+(strip.reverse?' · reversed':'');
				label.append(detail); const count = cE('span'); count.className = 'muted'; count.textContent = strip.count;
				item.append(swatch,label,count); item.addEventListener('click', () => { selectedId = strip.id; renderStrips(); renderInspector(); }); list.append(item);
			});
			if (!config.strips.length) { const empty = cE('div'); empty.className = 'empty'; empty.textContent = 'No strips yet. Add a strip to place LEDs on the wall.'; list.append(empty); }
			gId('addStrip').disabled = !config.controllers.length || config.strips.length >= 32;
		}

		// Endpoints are LED centres; reverse changes physical order along the same geometry.
		function renderInspector() {
			const panel = gId('inspector'); panel.replaceChildren(); const strip = selectedStrip();
			gId('selectionTitle').textContent = strip ? 'Strip '+strip.id : 'Selected strip'; gId('removeStrip').disabled = !strip;
			if (!strip) { const hint = cE('p'); hint.textContent = 'Select a strip in the layout or list to edit it.'; panel.append(hint); return; }
			const fields = cE('div'); fields.className = 'fields';
			field(fields,'Strip ID',strip.id,value => { strip.id = value; selectedId = value; renderStrips(); renderInspector(); },{min:1,max:65535,step:1});
			field(fields,'Controller',strip.controller,value => { strip.controller = Number(value); renderStrips(); },{choices:config.controllers.map(item => ({value:item.id,label:'Controller '+item.id}))});
			for (const [key,label,min,max] of [['start','First physical LED',0,4095],['count','LED count',1,4096],['x1','Start X (cm)',0,config.canvas.width],['y1','Start Y (cm)',0,config.canvas.height],['x2','End X (cm)',0,config.canvas.width],['y2','End Y (cm)',0,config.canvas.height]]) field(fields,label,strip[key],value => { strip[key] = value; renderStrips(); },{min,max,step:key==='start'||key==='count'?1:'any',key});
			const reverse = cE('label'); reverse.className = 'check'; const input = cE('input'); input.type = 'checkbox'; input.checked = strip.reverse;
			input.addEventListener('change', () => { strip.reverse = input.checked; renderStrips(); markDirty(); }); reverse.append(input,d.createTextNode('Reverse physical LED order'));
			const hint = cE('p'); hint.className = 'hint'; hint.textContent = 'Drag the strip to translate it. Drag either endpoint to change its angle and length. Endpoints describe the first and last LED centres.';
			panel.append(fields,reverse,hint);
		}
		function updateMetrics() {
			gId('wallMetric').textContent = (config.canvas.width/100).toLocaleString(undefined,{maximumFractionDigits:2})+' × '+(config.canvas.height/100).toLocaleString(undefined,{maximumFractionDigits:2})+' m';
			gId('ledMetric').textContent = config.controllers.reduce((sum,item) => sum+item.leds,0).toLocaleString(); gId('controllerMetric').textContent = config.controllers.length; gId('fpsMetric').textContent = config.fps+' FPS';
		}

		// Reject malformed imported snapshots before their properties enter the editor.
		function validateSnapshot(value) {
			const object = item => item && typeof item === 'object' && !Array.isArray(item);
			const number = (item,min,max,integer=false) => typeof item === 'number' && Number.isFinite(item) && item >= min && item <= max && (!integer || Number.isInteger(item));
			if (!object(value) || value.version !== 1 || typeof value.enabled !== 'boolean' || !object(value.canvas) || !number(value.canvas.width,0.000001,100000) || !number(value.canvas.height,0.000001,100000) || !number(value.fps,1,60,true) || !number(value.brightness,0,255,true)) throw Error('Invalid version, canvas dimensions, frame rate, or brightness.');
			const effect = value.effect;
			if (!object(effect) || !effectNames.includes(effect.name) || !number(effect.speed,-10,10) || !number(effect.wavelength,0.000001,100000) || !number(effect.direction,-360,360) || !number(effect.centerX,0,value.canvas.width) || !number(effect.centerY,0,value.canvas.height) || !number(effect.seed,0,4294967295,true)) throw Error('Invalid effect parameters.');
			if (!Array.isArray(value.controllers) || value.controllers.length > 8 || !Array.isArray(value.strips) || value.strips.length > 32) throw Error('Maximum: 8 controllers and 32 strips.');
			const ids = new Set(), ips = new Set(); let total = 0;
			for (const controller of value.controllers) {
				if (!object(controller) || !number(controller.id,1,65535,true) || ids.has(controller.id) || !number(controller.leds,1,4096,true) || typeof controller.ip !== 'string' || controller.ip.length > 15 || !/^(\d{1,3}\.){3}\d{1,3}$/.test(controller.ip)) throw Error('Invalid or duplicate controller ID, LED count, or IPv4 address.');
				const octets = controller.ip.split('.').map(Number); if (octets.some(item => item > 255) || octets[0] === 0 || octets[0] === 127 || octets[0] >= 224 || octets[3] === 255 || ips.has(octets.join('.'))) throw Error('Controller addresses must be unique unicast IPv4 addresses.');
				ids.add(controller.id); ips.add(octets.join('.')); total += controller.leds;
			}
			if (total > 4096) throw Error('Maximum total output buffer: 4096 LEDs.');
			const stripIds = new Set();
			for (let index=0; index<value.strips.length; index++) {
				const strip = value.strips[index], controller = object(strip) && value.controllers.find(item => item.id === strip.controller);
				if (!object(strip) || !number(strip.id,1,65535,true) || stripIds.has(strip.id) || !controller || !number(strip.start,0,4095,true) || !number(strip.count,1,4096,true) || strip.start+strip.count > controller.leds || typeof strip.reverse !== 'boolean' || !number(strip.x1,0,value.canvas.width) || !number(strip.x2,0,value.canvas.width) || !number(strip.y1,0,value.canvas.height) || !number(strip.y2,0,value.canvas.height)) throw Error('Invalid strip ID, output range, controller, or endpoint.');
				if (value.strips.slice(0,index).some(other => other.controller === strip.controller && strip.start < other.start+other.count && other.start < strip.start+strip.count)) throw Error('Physical LED ranges on the same controller cannot overlap.');
				stripIds.add(strip.id);
			}
			return value;
		}

		// Bound disconnected-master requests so polling cannot accumulate indefinitely.
		async function apiRequest(options = {}, path = apiPath) {
			const abort = new AbortController(), timeout = setTimeout(() => abort.abort(),5000);
			try {
				const response = await fetch(path,{...options,signal:abort.signal});
				// fetch resolves at headers; include body transfer in the same deadline before clearing the timer.
				await response.clone().text();
				return response;
			}
			catch (error) { throw Error(error.name === 'AbortError' ? 'Master request timed out.' : error.message); }
			finally { clearTimeout(timeout); }
		}
		// Preserve a local draft during status polling; only Reload replaces it.
		async function readMaster(replace = false) {
			const response = await apiRequest({cache:'no-store'});
			if (!response.ok) throw Error(response.status === 401 ? 'Settings are locked. Enter the WLED settings PIN and choose Unlock & load.' : 'Master request failed ('+response.status+').');
			const data = await response.json(); if (!data || !data.status) throw Error('Invalid master response.');
			lastStatus = data.status; showStatus();
			if (replace) { config = validateSnapshot(data.config); loaded = true; selectedId = config.strips.length ? config.strips[0].id : null; dirty = false; renderForms(); setBusy(busy); notice('Configuration loaded from the master.','ok'); }
			return data.status;
		}
		// Report only master-side counters; DDP provides no delivery acknowledgement.
		function showStatus() {
			if (!lastStatus) return;
			const status = lastStatus;
			gId('outputState').textContent = status.pausedForOta ? 'Paused for OTA' : status.enabled ? 'DDP output running' : 'DDP output OFF';
			gId('toggleOutput').textContent = status.enabled ? 'Stop wall' : 'Start wall';
			updateDeviceHealth();
			gId('runtime').textContent = 'Applied revision  '+status.revision+'\nSaved revision    '+status.savedRevision+'\nFrames rendered   '+status.frames+'\nSend errors       '+status.sendErrors+'\nLast frame        '+status.lastFrameUs+' µs\nFree heap         '+status.heap+' bytes\nLargest block     '+status.largestBlock+' bytes'+(status.pending?'\nUpdate pending…':'')+(status.lastError?'\n'+String(status.lastError):'');
			if (status.network) gId('runtime').textContent += '\nBuild             '+status.build+'\nUptime            '+Math.floor(status.uptimeMs/1000)+' s\nReset reason      '+status.resetReason+'\nWi-Fi status      '+status.wifiStatus+'\nLoop age          '+status.loopAgeMs+' ms\nNetwork phase     '+status.network.phase+'\nNetwork age       '+status.network.heartbeatAgeMs+' ms\nNetwork stack min '+status.network.stackMinimumFreeBytes+' bytes';
		}
		function setBusy(value) { busy = value; for (const id of ['apply','save','toggleOutput']) gId(id).disabled = value || !loaded; for (const id of ['reload','unlock']) gId(id).disabled = value; }

		// A queued update is complete only after the master reports its applied revision.
		async function submit(persist) {
			if (busy) return;
			try {
				validateSnapshot(config); setBusy(true); notice(persist?'Saving configuration on the master…':'Applying configuration on the master…');
				if (config.enabled && (!config.strips.length || !config.controllers.length || !config.brightness)) throw Error('To start the wall, assign at least one strip and controller and use brightness above zero.');
				const submitted = JSON.stringify(config), body = {config:JSON.parse(submitted),persist}; if (gId('pin').value) body.pin = gId('pin').value;
				const response = await apiRequest({method:'POST',headers:{'Content-Type':'application/json'},body:JSON.stringify(body)});
				if (!response.ok) { let message = ''; try { const result = await response.json(); message = typeof result.error === 'string' ? result.error : ''; } catch (_) {} throw Error(response.status === 401 ? 'Settings are locked. Enter the WLED settings PIN or unlock settings first.' : message || 'Update rejected ('+response.status+').'); }
				const result = await response.json(); if (!Number.isInteger(result.revision)) throw Error('Master did not return a revision.');
				for (let attempt=0; attempt<24; attempt++) {
					await new Promise(resolve => setTimeout(resolve,250)); const status = await readMaster();
					if (!status.pending && status.lastError && status.revision < result.revision) throw Error(String(status.lastError));
					if (status.revision >= result.revision && (!persist || status.savedRevision >= result.revision)) { dirty = JSON.stringify(config) !== submitted; notice((dirty?'Update confirmed. Your newer local edits have not been applied.':persist?'Saved on the master. This configuration will be restored after restart.':'Applied on the master. Save to restore this configuration after restart.')+(status.enabled?' Check receiver diagnostics for DDP reception.':' DDP output is OFF. Choose Start wall to illuminate the layout.'),'ok'); return; }
					if (!status.pending && status.revision >= result.revision && persist && status.savedRevision < result.revision && status.lastError) throw Error('Applied, but persistence failed: '+String(status.lastError));
				}
				throw Error('Update has not been confirmed. Check master status, then Reload before retrying.');
			} catch (error) { notice(error.message,'error'); }
			finally { setBusy(false); }
		}

		// Fit the world to the visible canvas while preserving physical aspect ratio.
		function resizeCanvas() {
			const rect = canvas.getBoundingClientRect(), ratio = window.devicePixelRatio || 1;
			const width = Math.max(1,Math.round(rect.width*ratio)), height = Math.max(1,Math.round(rect.height*ratio));
			if (canvas.width !== width || canvas.height !== height) { canvas.width = width; canvas.height = height; }
			context.setTransform(ratio,0,0,ratio,0,0);
			const scale = Math.min((rect.width-62)/Math.max(1,config.canvas.width),(rect.height-62)/Math.max(1,config.canvas.height));
			view = {scale,x:(rect.width-config.canvas.width*scale)/2,y:(rect.height-config.canvas.height*scale)/2,width:rect.width,height:rect.height};
		}
		function screenPoint(x,y) { return {x:view.x+x*view.scale,y:view.y+y*view.scale}; }
		function worldPoint(event) { const rect = canvas.getBoundingClientRect(); return {x:(event.clientX-rect.left-view.x)/view.scale,y:(event.clientY-rect.top-view.y)/view.scale}; }
		function clamp(value,min,max) { return Math.max(min,Math.min(max,value)); }

		// The lightweight browser preview illustrates geometry; firmware is authoritative.
		function previewColor(x,y,time) {
			const effect = config.effect, angle = effect.direction*Math.PI/180, projection = (x*Math.cos(angle)+y*Math.sin(angle))/Math.max(0.001,effect.wavelength), phase = projection-time*effect.speed;
			let hue = (((projection+time*effect.speed)%1)+1)%1, light = 52;
			if (effect.name === 'wave') { hue = 0.48; light = 10+45*(0.5+0.5*Math.sin(phase*Math.PI*2)); }
			if (effect.name === 'ripple') { const radius = Math.hypot(x-effect.centerX,y-effect.centerY); hue = 0.6; light = 8+48*(0.5+0.5*Math.sin((radius/Math.max(0.001,effect.wavelength)-time*effect.speed)*Math.PI*2)); }
			if (effect.name === 'noise') { const n = Math.sin(x*0.071+y*0.137+effect.seed*0.01+time*effect.speed*5); hue = 0.7+0.15*n; light = 12+40*Math.pow(0.5+n*0.5,3); }
			return 'hsl('+(hue*360)+' 85% '+Math.max(3,light*config.brightness/255)+'%)';
		}
		// Draw occupied positions only; the grid is a visual aid rather than a framebuffer.
		function draw(timestamp) {
			resizeCanvas(); const ctx = context, world = config.canvas;
			ctx.clearRect(0,0,view.width,view.height); ctx.lineWidth = 1;
			const step = Math.pow(10,Math.floor(Math.log10(Math.max(world.width,world.height)/5))) || 1;
			ctx.strokeStyle = '#242c36'; ctx.fillStyle = '#738092'; ctx.font = '10px system-ui';
			for (let x=0;x<=world.width;x+=step) { const point = screenPoint(x,0), end = screenPoint(x,world.height); ctx.beginPath();ctx.moveTo(point.x,point.y);ctx.lineTo(end.x,end.y);ctx.stroke();if (Math.round(x/step)%2===0) ctx.fillText(Math.round(x)+'',point.x-4,end.y+18); }
			for (let y=0;y<=world.height;y+=step) { const point = screenPoint(0,y), end = screenPoint(world.width,y);ctx.beginPath();ctx.moveTo(point.x,point.y);ctx.lineTo(end.x,end.y);ctx.stroke();ctx.fillText(Math.round(y)+'',point.x-27,point.y+3); }
			ctx.strokeStyle = '#42505f'; ctx.strokeRect(view.x,view.y,world.width*view.scale,world.height*view.scale);
			const time = gId('preview').checked ? timestamp/1000 : 0;
			config.strips.forEach((strip,index) => {
				const first = screenPoint(strip.x1,strip.y1), last = screenPoint(strip.x2,strip.y2), selected = strip.id === selectedId;
				ctx.lineCap='round';ctx.lineWidth=selected?8:6;ctx.strokeStyle=selected?'#516b66':'#303a45';ctx.beginPath();ctx.moveTo(first.x,first.y);ctx.lineTo(last.x,last.y);ctx.stroke();
				const dots = Math.min(strip.count,240);
				for (let led=0;led<dots;led++) { const amount=dots===1?0:led/(dots-1), x=strip.x1+(strip.x2-strip.x1)*amount, y=strip.y1+(strip.y2-strip.y1)*amount, point=screenPoint(x,y);ctx.fillStyle=previewColor(x,y,time);ctx.beginPath();ctx.arc(point.x,point.y,selected?2.7:2.2,0,Math.PI*2);ctx.fill(); }
				ctx.fillStyle=stripColors[index%stripColors.length];ctx.font='600 11px system-ui';ctx.fillText('S'+strip.id,(first.x+last.x)/2+8,(first.y+last.y)/2-11);
				const physicalFirst = strip.reverse?last:first;ctx.fillStyle='#e9edf4';ctx.beginPath();ctx.arc(physicalFirst.x,physicalFirst.y,3.5,0,Math.PI*2);ctx.fill();
				if (selected) for (const point of [first,last]) { ctx.fillStyle='#101318';ctx.strokeStyle='#a9ebce';ctx.lineWidth=2;ctx.beginPath();ctx.arc(point.x,point.y,7,0,Math.PI*2);ctx.fill();ctx.stroke(); }
			});
			requestAnimationFrame(draw);
		}

		// Prioritize endpoint handles, then find the nearest strip in screen pixels.
		canvas.addEventListener('pointerdown',event => {
			if (!view || busy) return; const point = worldPoint(event), current=selectedStrip(), threshold=16/view.scale;
			if (current) for (const end of [1,2]) if (Math.hypot(point.x-current['x'+end],point.y-current['y'+end]) <= threshold) { drag={strip:current,end,point,original:{...current}};canvas.setPointerCapture(event.pointerId);return; }
			let closest = null, distance = threshold;
			for (const strip of config.strips) { const dx=strip.x2-strip.x1,dy=strip.y2-strip.y1,length=dx*dx+dy*dy,amount=length?clamp(((point.x-strip.x1)*dx+(point.y-strip.y1)*dy)/length,0,1):0; const gap=Math.hypot(point.x-strip.x1-amount*dx,point.y-strip.y1-amount*dy);if(gap<=distance){closest=strip;distance=gap;} }
			selectedId=closest?closest.id:null;renderStrips();renderInspector();if(closest){drag={strip:closest,end:0,point,original:{...closest}};canvas.setPointerCapture(event.pointerId);}
		});
		canvas.addEventListener('pointermove',event => {
			if(!drag)return;const point=worldPoint(event),strip=drag.strip,original=drag.original;
			if(drag.end){strip['x'+drag.end]=clamp(point.x,0,config.canvas.width);strip['y'+drag.end]=clamp(point.y,0,config.canvas.height);}
			else{const dx=clamp(point.x-drag.point.x,-Math.min(original.x1,original.x2),config.canvas.width-Math.max(original.x1,original.x2)),dy=clamp(point.y-drag.point.y,-Math.min(original.y1,original.y2),config.canvas.height-Math.max(original.y1,original.y2));strip.x1=original.x1+dx;strip.x2=original.x2+dx;strip.y1=original.y1+dy;strip.y2=original.y2+dy;}
			for(const key of ['x1','y1','x2','y2']){const input=gId('inspector').querySelector('[data-key="'+key+'"]');if(input)input.value=Math.round(strip[key]*10)/10;}
		});
		function finishDrag(){if(drag){const moved=['x1','y1','x2','y2'].some(key=>drag.strip[key]!==drag.original[key]);drag=null;if(moved)markDirty();}}
		canvas.addEventListener('pointerup',finishDrag);canvas.addEventListener('pointercancel',finishDrag);canvas.addEventListener('lostpointercapture',finishDrag);
		gId('enabled').addEventListener('change',()=>{config.enabled=gId('enabled').checked;markDirty();});
		gId('apply').addEventListener('click',()=>submit(false));gId('save').addEventListener('click',()=>submit(true));
		gId('toggleOutput').addEventListener('click',()=>{config.enabled=!(lastStatus && lastStatus.enabled);gId('enabled').checked=config.enabled;markDirty();submit(false);});
		gId('scan').addEventListener('click',()=>networkAction('scan'));
		gId('probe').addEventListener('click',()=>networkAction('probe',gId('probeIp').value.trim()));
		gId('reload').addEventListener('click',async()=>{if(busy)return;setBusy(true);try{await readMaster(true);}catch(error){notice(error.message,'error');}finally{setBusy(false);}});
		gId('addController').addEventListener('click',()=>{if(!loaded||config.controllers.length>=8)return;const id=nextId(config.controllers);config.controllers.push({id,ip:'',leds:1});renderForms();markDirty();});
		gId('addStrip').addEventListener('click',()=>{if(!config.controllers.length||config.strips.length>=32)return;let destination=null;for(const controller of config.controllers){let start=0;const used=config.strips.filter(strip=>strip.controller===controller.id).sort((left,right)=>left.start-right.start);for(const strip of used){if(strip.start>start)break;start=Math.max(start,strip.start+strip.count);}const next=used.find(strip=>strip.start>start),available=(next?next.start:controller.leds)-start;if(available>0){destination={controller,start,count:Math.min(60,available)};break;}}if(!destination){notice('All configured LED ranges are assigned. Increase a controller\'s LED count or add another controller before adding a strip.','error');return;}const {controller,start,count}=destination,id=nextId(config.strips);config.strips.push({id,controller:controller.id,start,count,x1:config.canvas.width*0.2,y1:config.canvas.height*0.5,x2:config.canvas.width*0.8,y2:config.canvas.height*0.5,reverse:false});selectedId=id;renderForms();markDirty();});
		gId('removeStrip').addEventListener('click',()=>{config.strips=config.strips.filter(strip=>strip.id!==selectedId);selectedId=config.strips.length?config.strips[0].id:null;renderForms();markDirty();});
		gId('export').addEventListener('click',()=>{const blob=new Blob([JSON.stringify(config,null,2)+'\n'],{type:'application/json'}),url=URL.createObjectURL(blob),link=cE('a');link.href=url;link.download='ledwall.json';link.click();setTimeout(()=>URL.revokeObjectURL(url),1000);});
		gId('import').addEventListener('click',()=>gId('importFile').click());
		gId('importFile').addEventListener('change',async event=>{const file=event.target.files[0];if(!file)return;try{if(file.size>16384)throw Error('Configuration file exceeds 16 KiB.');const next=validateSnapshot(JSON.parse(await file.text()));config=next;selectedId=config.strips.length?config.strips[0].id:null;renderForms();markDirty();}catch(error){notice('Import failed: '+error.message,'error');}finally{event.target.value='';}});
		gId('unlock').addEventListener('click',async()=>{if(busy)return;setBusy(true);try{const response=await apiRequest({method:'POST',headers:{'Content-Type':'application/json'},body:JSON.stringify({pin:gId('pin').value})});if(!response.ok)throw Error(response.status===401?'PIN rejected.':'Unlock request failed ('+response.status+').');await readMaster(true);}catch(error){notice(error.message,'error');}finally{setBusy(false);}});
		window.addEventListener('beforeunload',event=>{if(dirty){event.preventDefault();event.returnValue='';}});
		renderForms();setBusy(false);requestAnimationFrame(draw);readMaster(true).then(readDevices).catch(error=>{notice(error.message+' No live layout loaded.','error');gId('runtime').textContent='Master unavailable. No delivery or runtime status confirmed.';});
		// Serialize polling and stop it in hidden tabs; opening several editors must not accumulate requests.
		setInterval(async()=>{if(d.hidden||busy||polling)return;polling=true;try{await readMaster(!loaded);await readDevices();}catch(_){gId('runtime').textContent='Master unreachable. Last received status may be stale.';gId('outputState').textContent='Master status unavailable';}finally{polling=false;}},5000);
		// AI: end
	</script>
</body>
</html>)LEDWALL";
// AI: end

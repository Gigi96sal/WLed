#include "wled.h"

// AI: below section was generated by an AI
namespace cinema {
namespace wled {

uint16_t CinemaConfig::totalLeds() const {
  const uint32_t total = static_cast<uint32_t>(topLeds) + rightLeds + bottomLeds + leftLeds;
  return total <= UINT16_MAX ? static_cast<uint16_t>(total) : 0;
}

bool CinemaConfig::isStructurallyValid() const {
  if (topLeds > MAX_CINEMA_LEDS || rightLeds > MAX_CINEMA_LEDS || bottomLeds > MAX_CINEMA_LEDS || leftLeds > MAX_CINEMA_LEDS) return false;
  if (totalLeds() > MAX_CINEMA_LEDS) return false;
  if (static_cast<uint8_t>(zeroCorner) > static_cast<uint8_t>(ZeroCorner::BottomLeft)) return false;
  if (!spi.isStructurallyValid()) return false;
  return !enabled || (generation != 0 && totalLeds() != 0 && spi.isComplete());
}

bool CinemaConfig::isValidForSegment(uint16_t segmentLength) const {
  return isStructurallyValid() && enabled && totalLeds() == segmentLength;
}

// A one-item queue keeps a coherent latest-requested snapshot available to both tasks.
// FreeRTOS copies the item atomically; SPI initialization never holds the queue lock.
CinemaController::CinemaController() {
#ifdef ARDUINO_ARCH_ESP32
  _configQueue = xQueueCreateStatic(1, sizeof(ConfigUpdate), _configQueueStorage, &_configQueueControl);
    const ConfigUpdate initial;
  xQueueOverwrite(_configQueue, &initial);
#endif
}

// Returns an independent snapshot so serialization never observes a partially updated request.
CinemaController::ConfigUpdate CinemaController::requestedConfig() const {
#ifdef ARDUINO_ARCH_ESP32
  ConfigUpdate update;
  xQueuePeek(_configQueue, &update, 0); // Seeded at construction and never drained.
  return update;
#else
  return _requestedConfig;
#endif
}

CinemaConfig CinemaController::config() const {
  return requestedConfig().config;
}

bool CinemaController::applyConfig(const CinemaConfig& config) {
  if (!config.isStructurallyValid()) return false;
  ConfigUpdate update;
  update.config = config;
#ifdef ARDUINO_ARCH_ESP32
  update.revision = _nextConfigRevision.fetch_add(1, std::memory_order_relaxed) + 1;
  return xQueueOverwrite(_configQueue, &update) == pdPASS;
#else
  update.revision = ++_nextConfigRevision;
  _requestedConfig = update;
  return true;
#endif
}

void CinemaController::begin() {
  _started = true;
  _hasAppliedConfig = false;
}

void CinemaController::service(uint32_t nowMillis) {
  if (!_started) return;
  const ConfigUpdate update = requestedConfig();
  if (!_hasAppliedConfig || update.revision != _appliedConfigRevision) {
    _spiMaster.end();
    _config = update.config;
    clearFrames();
    _appliedConfigRevision = update.revision;
    _hasAppliedConfig = true;
    if (_config.enabled) _spiMaster.begin(_config.spi);
  }

  protocol::PacketView packet;
  protocol::NodeRole expectedSource;
  if (_spiMaster.poll(&packet, &expectedSource, nowMillis)) processPacket(packet, expectedSource, nowMillis);
}

const CameraRuntimeStatus& CinemaController::cameraStatus(CameraSide side) const {
  return side == CameraSide::Left ? _leftStatus : _rightStatus;
}

bool CinemaController::isCameraConnected(CameraSide side, uint32_t nowMillis) const {
  const CameraRuntimeStatus& status = cameraStatus(side);
  return status.seen && static_cast<uint32_t>(nowMillis - status.lastPacketMillis) <= CAMERA_LINK_TIMEOUT_MS;
}

bool CinemaController::acceptFrame(const protocol::PacketView& packet, uint32_t nowMillis) {
  if (!_config.enabled || packet.header.type != protocol::MessageType::FrameRgb) return false;

  CameraSide side;
  if (!packetSourceToSide(packet.header.source, &side)) return false;

  protocol::FrameRgbView frame;
  if (protocol::decodeFrameRgbPayload(packet.payload, packet.payloadSize, &frame) != protocol::PacketStatus::Ok) return false;
  if (frame.header.configGeneration != _config.generation || frame.header.slotCount != expectedSlotCount(side)) return false;

  CameraRuntimeStatus& status = statusForSide(side);
  if (status.framesReceived > 0 && static_cast<int32_t>(frame.header.frameId - status.lastFrameId) <= 0) return false;

  PixelStorage& pixels = pixelsForSide(side);
  uint16_t sourceSlot = 0;
  for (uint16_t canonicalSlot = 0; canonicalSlot < _config.totalLeds(); canonicalSlot++) {
    if (ownerForCanonicalSlot(canonicalSlot) != side) continue;
    const size_t sourceOffset = static_cast<size_t>(sourceSlot++) * 3;
    const size_t targetOffset = static_cast<size_t>(canonicalSlot) * 3;
    pixels[targetOffset] = frame.colors[sourceOffset];
    pixels[targetOffset + 1] = frame.colors[sourceOffset + 1];
    pixels[targetOffset + 2] = frame.colors[sourceOffset + 2];
  }

  frameTimeForSide(side) = nowMillis;
  status.lastFrameId = frame.header.frameId;
  status.framesReceived++;
  return true;
}

bool CinemaController::render(Segment& segment) {
  if (!_config.isValidForSegment(segment.virtualLength())) return false;
  // Frame arrivals use uptime, independently of WLED's resettable/synchronized effect clock.
  const uint32_t nowMillis = millis();
  const bool leftFresh = hasFreshFrame(CameraSide::Left, nowMillis);
  const bool rightFresh = hasFreshFrame(CameraSide::Right, nowMillis);

  for (uint16_t canonicalSlot = 0; canonicalSlot < _config.totalLeds(); canonicalSlot++) {
    const CameraSide side = ownerForCanonicalSlot(canonicalSlot);
    const PixelStorage& pixels = pixelsForSide(side);
    const size_t offset = static_cast<size_t>(canonicalSlot) * 3;
    if (!(side == CameraSide::Left ? leftFresh : rightFresh)) {
      // A missing camera must go fully dark even at the highest smoothing setting.
      _smoothedPixels[offset] = _smoothedPixels[offset + 1] = _smoothedPixels[offset + 2] = 0;
      segment.setPixelColor(physicalIndexForCanonicalSlot(canonicalSlot), 0);
      continue;
    }
    uint8_t red = pixels[offset];
    uint8_t green = pixels[offset + 1];
    uint8_t blue = pixels[offset + 2];
    correctColor(canonicalSlot, &red, &green, &blue);
    const uint32_t color = RGBW32(red, green, blue, 0);
    segment.setPixelColor(physicalIndexForCanonicalSlot(canonicalSlot), color);
  }
  return true;
}

uint16_t CinemaController::expectedSlotCount(CameraSide side) const {
  if (!_config.isStructurallyValid()) return 0;

  uint16_t count = 0;
  for (uint16_t canonicalSlot = 0; canonicalSlot < _config.totalLeds(); canonicalSlot++) {
    if (ownerForCanonicalSlot(canonicalSlot) == side) count++;
  }
  return count;
}

CameraSide CinemaController::ownerForCanonicalSlot(uint16_t canonicalSlot) const {
  const uint16_t topEnd = _config.topLeds;
  const uint16_t rightEnd = topEnd + _config.rightLeds;
  const uint16_t bottomEnd = rightEnd + _config.bottomLeds;

  if (canonicalSlot < topEnd) return canonicalSlot < (_config.topLeds / 2) ? CameraSide::Left : CameraSide::Right;
  if (canonicalSlot < rightEnd) return CameraSide::Right;
  if (canonicalSlot < bottomEnd) {
    const uint16_t bottomSlot = canonicalSlot - rightEnd;
    const uint16_t rightShare = _config.bottomLeds - (_config.bottomLeds / 2);
    return bottomSlot < rightShare ? CameraSide::Right : CameraSide::Left;
  }
  return CameraSide::Left;
}

uint16_t CinemaController::physicalIndexForCanonicalSlot(uint16_t canonicalSlot) const {
  const uint16_t total = _config.totalLeds();
  uint16_t origin = 0;
  switch (_config.zeroCorner) {
    case ZeroCorner::TopLeft: break;
    case ZeroCorner::TopRight: origin = _config.topLeds; break;
    case ZeroCorner::BottomRight: origin = _config.topLeds + _config.rightLeds; break;
    case ZeroCorner::BottomLeft: origin = _config.topLeds + _config.rightLeds + _config.bottomLeds; break;
  }

  if (_config.clockwise) return static_cast<uint16_t>((canonicalSlot + total - origin) % total);
  return static_cast<uint16_t>((origin + total - canonicalSlot) % total);
}

bool CinemaController::hasFreshFrame(CameraSide side, uint32_t nowMillis) const {
  const uint32_t frameTime = frameTimeForSide(side);
  return cameraStatus(side).framesReceived > 0 && static_cast<uint32_t>(nowMillis - frameTime) <= CAMERA_FRAME_TIMEOUT_MS;
}

const CinemaController::PixelStorage& CinemaController::pixelsForSide(CameraSide side) const {
  return side == CameraSide::Left ? _leftPixels : _rightPixels;
}

CinemaController::PixelStorage& CinemaController::pixelsForSide(CameraSide side) {
  return side == CameraSide::Left ? _leftPixels : _rightPixels;
}

uint32_t CinemaController::frameTimeForSide(CameraSide side) const {
  return side == CameraSide::Left ? _leftFrameMillis : _rightFrameMillis;
}

uint32_t& CinemaController::frameTimeForSide(CameraSide side) {
  return side == CameraSide::Left ? _leftFrameMillis : _rightFrameMillis;
}

CameraRuntimeStatus& CinemaController::statusForSide(CameraSide side) {
  return side == CameraSide::Left ? _leftStatus : _rightStatus;
}

bool CinemaController::processPacket(const protocol::PacketView& packet, protocol::NodeRole expectedSource, uint32_t nowMillis) {
  if (packet.header.target != protocol::NodeRole::Controller || packet.header.source != expectedSource) return false;

  CameraSide side;
  if (!packetSourceToSide(packet.header.source, &side)) return false;
  CameraRuntimeStatus& status = statusForSide(side);
  if (status.seen && status.bootId == packet.header.bootId && static_cast<int32_t>(packet.header.sequence - status.lastSequence) <= 0) return false;
  if (!status.seen || status.bootId != packet.header.bootId) {
    clearSide(side);
    status = CameraRuntimeStatus();
    status.seen = true;
    status.bootId = packet.header.bootId;
  }
  status.lastPacketMillis = nowMillis;
  status.lastSequence = packet.header.sequence;

  if (packet.header.type == protocol::MessageType::Heartbeat) return true;
  if (packet.header.type == protocol::MessageType::FrameRgb) return acceptFrame(packet, nowMillis);
  return false;
}

bool CinemaController::packetSourceToSide(protocol::NodeRole source, CameraSide* side) const {
  if (!side) return false;
  if (source == protocol::NodeRole::CameraLeft) {
    *side = CameraSide::Left;
    return true;
  }
  if (source == protocol::NodeRole::CameraRight) {
    *side = CameraSide::Right;
    return true;
  }
  return false;
}

void CinemaController::correctColor(uint16_t canonicalSlot, uint8_t* red, uint8_t* green, uint8_t* blue) {
  uint8_t channels[] = {*red, *green, *blue};
  uint8_t maximum = std::max(channels[0], std::max(channels[1], channels[2]));
  if (maximum <= _config.color.blackThreshold) {
    channels[0] = channels[1] = channels[2] = 0;
  } else {
    uint16_t saturationBoost = _config.color.colorBoost;
    if (maximum < 96 && _config.color.darkColorBoost > 0) {
      const uint8_t darkness = 96 - maximum;
      const uint16_t boostedMaximum = maximum + ((96 - maximum) * _config.color.darkColorBoost + 127) / 255;
      for (uint8_t& channel : channels) channel = static_cast<uint8_t>((static_cast<uint16_t>(channel) * boostedMaximum + maximum / 2) / maximum);
      maximum = static_cast<uint8_t>(boostedMaximum);
      const uint16_t darkContribution = (static_cast<uint32_t>(_config.color.darkColorBoost) * darkness + 48) / 96;
      saturationBoost += ((255 - saturationBoost) * darkContribution + 127) / 255;
    }

    const uint8_t minimum = std::min(channels[0], std::min(channels[1], channels[2]));
    const uint8_t chroma = maximum - minimum;
    if (chroma > 0 && saturationBoost > 0) {
      const uint16_t boostedChroma = chroma + ((maximum - chroma) * saturationBoost + 127) / 255;
      for (uint8_t& channel : channels) {
        channel = static_cast<uint8_t>(maximum - ((static_cast<uint16_t>(maximum - channel) * boostedChroma + chroma / 2) / chroma));
      }
    }
  }

  const size_t offset = static_cast<size_t>(canonicalSlot) * 3;
  const uint16_t historyWeight = _config.color.smoothness;
  const uint16_t targetWeight = 256 - historyWeight;
  for (uint8_t index = 0; index < 3; index++) {
    // Retaining the fractional channel avoids the nonzero fixed points of an 8-bit filter.
    const uint32_t target = static_cast<uint32_t>(channels[index]) << 8;
    _smoothedPixels[offset + index] = static_cast<uint16_t>((static_cast<uint32_t>(_smoothedPixels[offset + index]) * historyWeight + target * targetWeight + 128) >> 8);
  }
  *red = _smoothedPixels[offset] >> 8;
  *green = _smoothedPixels[offset + 1] >> 8;
  *blue = _smoothedPixels[offset + 2] >> 8;
}

void CinemaController::clearFrames() {
  clearSide(CameraSide::Left);
  clearSide(CameraSide::Right);
  _leftStatus = CameraRuntimeStatus();
  _rightStatus = CameraRuntimeStatus();
  _smoothedPixels.fill(0);
}

void CinemaController::clearSide(CameraSide side) {
  pixelsForSide(side).fill(0);
  frameTimeForSide(side) = 0;
  for (uint16_t slot = 0; slot < _config.totalLeds(); slot++) {
    if (ownerForCanonicalSlot(slot) != side) continue;
    const size_t offset = static_cast<size_t>(slot) * 3;
    _smoothedPixels[offset] = _smoothedPixels[offset + 1] = _smoothedPixels[offset + 2] = 0;
  }
}

} // namespace wled
} // namespace cinema
// AI: end

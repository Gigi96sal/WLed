#include "wled.h"

#ifdef ARDUINO_ARCH_ESP32
#include <driver/gpio.h>
#include <driver/spi_master.h>
#include <esp_heap_caps.h>
#include <esp_rom_gpio.h>
#include <esp_system.h>
#include <soc/spi_periph.h>
#endif

// AI: below section was generated by an AI
namespace cinema {
namespace wled {

bool CinemaSpiConfig::hasAnyPin() const {
  return sclkPin >= 0 || mosiPin >= 0 || misoPin >= 0 || rightMisoPin >= 0 || leftCsPin >= 0 || rightCsPin >= 0;
}

bool CinemaSpiConfig::isComplete() const {
  return sclkPin >= 0 && mosiPin >= 0 && misoPin >= 0 && rightMisoPin >= 0 && leftCsPin >= 0 && rightCsPin >= 0;
}

bool CinemaSpiConfig::isStructurallyValid() const {
  if (frequencyHz < MIN_SPI_FREQUENCY_HZ || frequencyHz > MAX_SPI_FREQUENCY_HZ) return false;
  if (!hasAnyPin()) return true;

  const int8_t pins[] = {sclkPin, mosiPin, misoPin, rightMisoPin, leftCsPin, rightCsPin};
  for (size_t first = 0; first < sizeof(pins); first++) {
    if (pins[first] < -1) return false;
    if (pins[first] == -1) continue; // Disabled configurations may await explicit wiring of a missing input.
    for (size_t second = first + 1; second < sizeof(pins); second++) {
      if (pins[first] == pins[second]) return false;
    }
  }
  return true;
}

bool CinemaSpiMaster::begin(const CinemaSpiConfig& config, const stream::Config& streamConfig) {
  end();
  _config = config;
  _streamConfig = streamConfig;
  if (!config.isStructurallyValid() || !config.isComplete() || !streamConfig.isValid()) {
    _status = CinemaSpiStatus::InvalidConfig;
    return false;
  }

#ifdef ARDUINO_ARCH_ESP32
  const managed_pin_type pins[] = {
    {config.sclkPin, true},
    {config.mosiPin, true},
    {config.misoPin, false},
    {config.rightMisoPin, false},
    {config.leftCsPin, true},
    {config.rightCsPin, true}
  };
  if (!PinManager::allocateMultiplePins(pins, sizeof(pins) / sizeof(pins[0]), PinOwner::Cinema)) {
    _status = CinemaSpiStatus::PinConflict;
    return false;
  }
  _pinsAllocated = true;

  _txBuffer = static_cast<uint8_t*>(heap_caps_malloc(spi::SLOT_SIZE, MALLOC_CAP_DMA | MALLOC_CAP_INTERNAL));
  _rxBuffer = static_cast<uint8_t*>(heap_caps_malloc(spi::SLOT_SIZE, MALLOC_CAP_DMA | MALLOC_CAP_INTERNAL));
  if (!_txBuffer || !_rxBuffer) {
    end();
    _status = CinemaSpiStatus::NoMemory;
    return false;
  }

  spi_bus_config_t busConfig = {};
  busConfig.mosi_io_num = config.mosiPin;
  busConfig.miso_io_num = config.misoPin;
  busConfig.sclk_io_num = config.sclkPin;
  busConfig.quadwp_io_num = -1;
  busConfig.quadhd_io_num = -1;
  busConfig.max_transfer_sz = spi::SLOT_SIZE;
  // Both return wires stay electrically separate. The GPIO matrix selects the active camera.
  // ESP32 slave MISO is not guaranteed to be high impedance with CS inactive:
  // https://docs.espressif.com/projects/esp-idf/en/stable/esp32/api-reference/peripherals/spi_slave.html#restrictions-and-known-issues
  busConfig.flags = SPICOMMON_BUSFLAG_GPIO_PINS;
  if (spi_bus_initialize(SPI2_HOST, &busConfig, SPI_DMA_CH_AUTO) != ESP_OK) {
    end();
    _status = CinemaSpiStatus::BusUnavailable;
    return false;
  }
  _busInitialized = true;
  if (gpio_set_direction(static_cast<gpio_num_t>(config.misoPin), GPIO_MODE_INPUT) != ESP_OK
      || gpio_set_direction(static_cast<gpio_num_t>(config.rightMisoPin), GPIO_MODE_INPUT) != ESP_OK) {
    end();
    _status = CinemaSpiStatus::InvalidConfig;
    return false;
  }

  spi_device_interface_config_t deviceConfig = {};
  deviceConfig.clock_speed_hz = config.frequencyHz;
  deviceConfig.mode = 0;
  deviceConfig.queue_size = 1;
  deviceConfig.spics_io_num = config.leftCsPin;
  spi_device_handle_t leftDevice = nullptr;
  if (spi_bus_add_device(SPI2_HOST, &deviceConfig, &leftDevice) != ESP_OK) {
    end();
    _status = CinemaSpiStatus::BusUnavailable;
    return false;
  }
  _leftDevice = leftDevice;

  deviceConfig.spics_io_num = config.rightCsPin;
  spi_device_handle_t rightDevice = nullptr;
  if (spi_bus_add_device(SPI2_HOST, &deviceConfig, &rightDevice) != ESP_OK) {
    end();
    _status = CinemaSpiStatus::BusUnavailable;
    return false;
  }
  _rightDevice = rightDevice;
  _controllerBootId = esp_random();
  if (_controllerBootId == 0) _controllerBootId = 1;
  _status = CinemaSpiStatus::Ready;
  DEBUG_PRINTF("Cinema SPI master: ready, SCLK=%d MOSI=%d MISO-left=%d MISO-right=%d CS-left=%d CS-right=%d Hz=%lu\n", config.sclkPin, config.mosiPin, config.misoPin, config.rightMisoPin, config.leftCsPin, config.rightCsPin, static_cast<unsigned long>(config.frequencyHz));
  return true;
#else
  _status = CinemaSpiStatus::BusUnavailable;
  return false;
#endif
}

void CinemaSpiMaster::end() {
#ifdef ARDUINO_ARCH_ESP32
  if (_rightDevice) spi_bus_remove_device(static_cast<spi_device_handle_t>(_rightDevice));
  if (_leftDevice) spi_bus_remove_device(static_cast<spi_device_handle_t>(_leftDevice));
  if (_busInitialized) spi_bus_free(SPI2_HOST);
  if (_rxBuffer) heap_caps_free(_rxBuffer);
  if (_txBuffer) heap_caps_free(_txBuffer);
#endif
  _rightDevice = nullptr;
  _leftDevice = nullptr;
  _rxBuffer = nullptr;
  _txBuffer = nullptr;
  _busInitialized = false;
  releasePins();
  _lastPollMillis = 0;
  _slotSequence = 0;
  _controllerBootId = 0;
  _frameIsFresh = false;
  for (auto& side : _requests) for (auto& request : side) request = PollRecord();
  _nextRequest[0] = _nextRequest[1] = 0;
  _leftPolls = 0;
  _rightPolls = 0;
  _validSlots = 0;
  _slotErrors = 0;
  _transferErrors = 0;
  _lastDiagnosticsMillis = 0;
  _pollLeft = true;
  _status = CinemaSpiStatus::Disabled;
}

bool CinemaSpiMaster::poll(protocol::PacketView* packet, protocol::NodeRole* expectedSource, uint32_t nowMillis) {
  if (!packet || !expectedSource || !isReady() || static_cast<uint32_t>(nowMillis - _lastPollMillis) < SPI_POLL_INTERVAL_MS) return false;
  _lastPollMillis = nowMillis;

#ifdef ARDUINO_ARCH_ESP32
  const bool pollingLeft = _pollLeft;
  const uint8_t side = pollingLeft ? 0 : 1;
  const protocol::NodeRole role = pollingLeft ? protocol::NodeRole::CameraLeft : protocol::NodeRole::CameraRight;
  protocol::PacketHeader command;
  command.type = protocol::MessageType::StreamConfigure;
  command.source = protocol::NodeRole::Controller;
  command.target = role;
  command.bootId = _controllerBootId;
  command.sequence = ++_slotSequence;
  uint8_t payload[stream::CONFIG_SIZE];
  uint8_t requestPacket[protocol::PACKET_HEADER_SIZE + stream::CONFIG_SIZE + protocol::PACKET_CRC_SIZE];
  size_t requestSize = 0;
  if (!stream::encodeConfig(_streamConfig, payload, sizeof(payload))
      || protocol::encodePacket(command, payload, sizeof(payload), requestPacket, sizeof(requestPacket), &requestSize) != protocol::PacketStatus::Ok
      || spi::encodeSlot(requestPacket, requestSize, 0, _slotSequence, _txBuffer, spi::SLOT_SIZE) != spi::SlotStatus::Ok) return false;

  spi_transaction_t transaction = {};
  transaction.length = spi::SLOT_SIZE * 8;
  transaction.rxlength = spi::SLOT_SIZE * 8;
  transaction.tx_buffer = _txBuffer;
  transaction.rx_buffer = _rxBuffer;
  spi_device_handle_t device = static_cast<spi_device_handle_t>(pollingLeft ? _leftDevice : _rightDevice);
  _pollLeft = !_pollLeft;
  if (pollingLeft) _leftPolls++;
  else _rightPolls++;
  // This dedicated host has no outstanding transfers; switch only while both CS lines are idle.
  const int8_t misoPin = pollingLeft ? _config.misoPin : _config.rightMisoPin;
  esp_rom_gpio_connect_in_signal(misoPin, spi_periph_signal[SPI2_HOST].spiq_in, false);
  if (!device || spi_device_transmit(device, &transaction) != ESP_OK) {
    _transferErrors++;
    reportDiagnostics(nowMillis);
    return false;
  }
  // MOSI can be intact even when the return slot is corrupt or the camera has no frame yet.
  _requests[side][_nextRequest[side]] = {_slotSequence, nowMillis, true};
  _nextRequest[side] = (_nextRequest[side] + 1) % stream::REQUEST_HISTORY_SIZE;

  spi::SlotView slot;
  if (spi::decodeSlot(_rxBuffer, spi::SLOT_SIZE, &slot) != spi::SlotStatus::Ok) {
    _slotErrors++;
    reportDiagnostics(nowMillis);
    return false;
  }
  _validSlots++;
  reportDiagnostics(nowMillis);
  // A full-duplex response was queued before this command. Validate against earlier polls only:
  // a stopped master must never make a camera's old DMA slot look like a newly captured frame.
  bool fresh = slot.packet.header.type != protocol::MessageType::FrameRgb;
  if (!fresh) {
    protocol::FrameRgbView frame;
    if (protocol::decodeFrameRgbPayload(slot.packet.payload, slot.packet.payloadSize, &frame) == protocol::PacketStatus::Ok
        && frame.header.controllerBootId == _controllerBootId && frame.header.pollSequence != _slotSequence) {
      for (const auto& request : _requests[side]) {
        if (request.valid && request.sequence == frame.header.pollSequence
            && static_cast<uint32_t>(nowMillis - request.sentMillis) <= stream::FRAME_TIMEOUT_MS) {
          _frameRequestMillis = request.sentMillis;
          fresh = true;
          break;
        }
      }
    }
  }
  // A stale RGB response still proves that the wired link is alive; only its colors are rejected.
  _frameIsFresh = fresh;
  *packet = slot.packet;
  *expectedSource = role;
  return true;
#else
  return false;
#endif
}

void CinemaSpiMaster::reportDiagnostics(uint32_t nowMillis) {
  if (static_cast<uint32_t>(nowMillis - _lastDiagnosticsMillis) < 1000) return;
  _lastDiagnosticsMillis = nowMillis;
  DEBUG_PRINTF("Cinema SPI master: polls L/R=%lu/%lu valid=%lu slot-errors=%lu transfer-errors=%lu\n",
    static_cast<unsigned long>(_leftPolls), static_cast<unsigned long>(_rightPolls), static_cast<unsigned long>(_validSlots),
    static_cast<unsigned long>(_slotErrors), static_cast<unsigned long>(_transferErrors));
}

void CinemaSpiMaster::releasePins() {
  if (!_pinsAllocated) return;
  const managed_pin_type pins[] = {
    {_config.sclkPin, true},
    {_config.mosiPin, true},
    {_config.misoPin, false},
    {_config.rightMisoPin, false},
    {_config.leftCsPin, true},
    {_config.rightCsPin, true}
  };
  PinManager::deallocateMultiplePins(pins, sizeof(pins) / sizeof(pins[0]), PinOwner::Cinema);
  _pinsAllocated = false;
}

} // namespace wled
} // namespace cinema
// AI: end

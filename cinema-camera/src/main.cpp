#include <Arduino.h>
#include <algorithm>
#include <esp_timer.h>

#include "camera_service.h"
#include "spi_slave_endpoint.h"

#ifndef CINEMA_CAMERA_ROLE
#error CINEMA_CAMERA_ROLE must identify the left or right camera
#endif

// AI: below section was generated by an AI
namespace {

cinema::camera::CameraService cameraService;
cinema::camera::SpiSlaveEndpoint spiEndpoint(static_cast<cinema::protocol::NodeRole>(CINEMA_CAMERA_ROLE));
cinema::stream::Frame rgbFrame;
bool streamingReady = false;
uint32_t frameId = 0;
uint64_t lastCaptureUs = 0;
uint64_t lastAttemptUs = 0;
uint64_t lastPublishedUs = 0;
uint32_t lastPreviewId = 0;
uint32_t lastPreviewControllerBootId = 0;

void spiTask(void*) {
  while (true) spiEndpoint.run();
}

} // namespace

void setup() {
  Serial.begin(115200);
  if (!cameraService.begin()) {
    Serial.println("Cinema camera initialization failed");
    return;
  }
  if (!spiEndpoint.begin()) {
    Serial.println("Cinema SPI slave initialization failed");
    return;
  }
  if (xTaskCreatePinnedToCore(spiTask, "CinemaSPI", 4096, nullptr, 3, nullptr, 0) != pdPASS) {
    Serial.println("Cinema SPI task creation failed");
    return;
  }
  streamingReady = true;
}

// Acquisition may wait for the sensor; keeping it on this task leaves SPI responsive throughout.
void loop() {
  if (!streamingReady) { delay(100); return; }
  cinema::stream::CaptureRequest request;
  const uint64_t nowUs = esp_timer_get_time();
  if (!spiEndpoint.captureRequest(&request) || request.count == 0
      || nowUs - lastAttemptUs < 1000000U / request.config.fps) {
    delay(1);
    return;
  }
  const auto role = static_cast<cinema::protocol::NodeRole>(CINEMA_CAMERA_ROLE);
  const auto& settings = role == cinema::protocol::NodeRole::CameraLeft ? request.config.leftCamera : request.config.rightCamera;
  if (!cameraService.configure(settings)) { delay(1); return; }
  lastAttemptUs = nowUs;
  if (request.previewId != 0 && (request.previewId != lastPreviewId || request.controllerBootId != lastPreviewControllerBootId)) {
    const auto photoRequest = request;
    camera_fb_t* photo = cameraService.capturePreview();
    if (spiEndpoint.captureRequest(&request) && request.previewId == photoRequest.previewId
        && request.controllerBootId == photoRequest.controllerBootId && request.config == photoRequest.config) {
      const bool freshPhoto = photo && (static_cast<uint64_t>(photo->timestamp.tv_sec) * 1000000ULL + photo->timestamp.tv_usec) >= photoRequest.previewStartedUs;
      const bool copied = freshPhoto ? spiEndpoint.publishPreview(request, photo->buf, photo->len, photo->width, photo->height)
                                : spiEndpoint.publishPreview(request, nullptr, 0, 0, 0);
      if (copied) { lastPreviewId = request.previewId; lastPreviewControllerBootId = request.controllerBootId; }
    }
    cameraService.release(photo);
    cameraService.resumeStream();
    delay(1);
    return;
  }
  camera_fb_t* frame = cameraService.acquire();
  if (!frame) { delay(1); return; }
  const uint64_t captureUs = static_cast<uint64_t>(frame->timestamp.tv_sec) * 1000000ULL + frame->timestamp.tv_usec;
  const uint8_t* image = cameraService.decode(frame);
  uint32_t pollSequence = 0;
  if (image && captureUs > lastCaptureUs && spiEndpoint.captureRequest(&request)
      && (role == cinema::protocol::NodeRole::CameraLeft ? request.config.leftCamera : request.config.rightCamera) == cameraService.settings()
      && request.requestForCapture(captureUs, esp_timer_get_time(), &pollSequence)
      && cinema::stream::sampleBgr888(request.config, role, image, cinema::camera::DECODED_SIZE,
          cinema::camera::STREAM_WIDTH, cinema::camera::STREAM_HEIGHT, rgbFrame.colors, sizeof(rgbFrame.colors))) {
    rgbFrame.header.configGeneration = request.config.generation;
    rgbFrame.header.controllerBootId = request.controllerBootId;
    rgbFrame.header.pollSequence = pollSequence;
    rgbFrame.header.frameId = ++frameId;
    rgbFrame.header.captureTimeUs = captureUs;
    rgbFrame.header.slotCount = cinema::stream::slotCount(request.config, role);
    const uint64_t interval = captureUs - lastPublishedUs;
    rgbFrame.header.fpsQ8_8 = lastPublishedUs > 0 && interval > 0 ? static_cast<uint16_t>(std::min<uint64_t>(UINT16_MAX, 256000000ULL / interval)) : 0;
    spiEndpoint.publishFrame(rgbFrame);
    lastPublishedUs = captureUs;
    lastCaptureUs = captureUs;
  }
  cameraService.release(frame);
  delay(1);
}
// AI: end

#include "spi_slave_endpoint.h"

#include <Arduino.h>
#include <driver/spi_slave.h>
#include <esp_heap_caps.h>
#include <esp_system.h>
#include <esp_timer.h>

#include "camera_pins.h"

// AI: below section was generated by an AI
namespace cinema {
namespace camera {

bool SpiSlaveEndpoint::begin() {
  end();
  _txBuffer = static_cast<uint8_t*>(heap_caps_malloc(spi::SLOT_SIZE, MALLOC_CAP_DMA | MALLOC_CAP_INTERNAL));
  _rxBuffer = static_cast<uint8_t*>(heap_caps_malloc(spi::SLOT_SIZE, MALLOC_CAP_DMA | MALLOC_CAP_INTERNAL));
  if (!_txBuffer || !_rxBuffer) {
    end();
    return false;
  }

  spi_bus_config_t busConfig = {};
  busConfig.mosi_io_num = pins::SPI_MOSI;
  busConfig.miso_io_num = pins::SPI_MISO;
  busConfig.sclk_io_num = pins::SPI_SCLK;
  busConfig.quadwp_io_num = -1;
  busConfig.quadhd_io_num = -1;
  busConfig.max_transfer_sz = spi::SLOT_SIZE;

  spi_slave_interface_config_t slaveConfig = {};
  slaveConfig.mode = 0;
  slaveConfig.spics_io_num = pins::SPI_CS;
  slaveConfig.queue_size = 1;
  if (spi_slave_initialize(SPI2_HOST, &busConfig, &slaveConfig, SPI_DMA_CH_AUTO) != ESP_OK) {
    end();
    return false;
  }
  _initialized = true;
  _previewMutex = xSemaphoreCreateMutexStatic(&_previewMutexControl);
  _previewPixels = static_cast<uint8_t*>(heap_caps_malloc(preview::IMAGE_SIZE, MALLOC_CAP_SPIRAM | MALLOC_CAP_8BIT));
  _previewId = _previewControllerBootId = 0;
  _previewTurn = false;
  if (!_previewMutex || !_previewPixels) { end(); return false; }

  _request = stream::CaptureRequest();
  _requestQueue = xQueueCreateStatic(1, sizeof(stream::CaptureRequest), _requestQueueStorage, &_requestQueueControl);
  _frameQueue = xQueueCreateStatic(1, sizeof(stream::Frame), _frameQueueStorage, &_frameQueueControl);
  if (!_requestQueue || !_frameQueue) {
    end();
    return false;
  }

  _bootId = esp_random();
  _packetSequence = _slotSequence = 0;
  Serial.printf("Cinema SPI slave: ready, role=%u HSPI SCLK=%d MOSI=%d MISO=%d CS=%d boot=%lu\n", static_cast<unsigned>(_role), pins::SPI_SCLK, pins::SPI_MOSI, pins::SPI_MISO, pins::SPI_CS, static_cast<unsigned long>(_bootId));
  if (prepareHeartbeat()) return true;
  end();
  return false;
}

void SpiSlaveEndpoint::end() {
  if (_initialized) spi_slave_free(SPI2_HOST);
  if (_rxBuffer) heap_caps_free(_rxBuffer);
  if (_txBuffer) heap_caps_free(_txBuffer);
  if (_previewPixels) heap_caps_free(_previewPixels);
  if (_previewMutex) vSemaphoreDelete(_previewMutex);
  _previewPixels = nullptr;
  _previewMutex = nullptr;
  _rxBuffer = nullptr;
  _txBuffer = nullptr;
  _initialized = false;
  _requestQueue = _frameQueue = nullptr;
}

void SpiSlaveEndpoint::run() {
  spi_slave_transaction_t transaction = {};
  transaction.length = spi::SLOT_SIZE * 8;
  transaction.tx_buffer = _txBuffer;
  transaction.rx_buffer = _rxBuffer;

  if (spi_slave_transmit(SPI2_HOST, &transaction, portMAX_DELAY) == ESP_OK) {
    _transactionCount++;
    processReceivedSlot(transaction.trans_len / 8);
    prepareNextSlot();
    reportDiagnostics(millis());
  }
  delay(1);
}

bool SpiSlaveEndpoint::prepareHeartbeat() {
  return preparePacket(protocol::MessageType::Heartbeat, nullptr, 0);
}

// Only the SPI task touches DMA storage, and only after the previous transaction has completed.
bool SpiSlaveEndpoint::prepareNextSlot() {
  if (_previewTurn && preparePreviewChunk()) { _previewTurn = false; return true; }
  _previewTurn = true;
  if (xQueueReceive(_frameQueue, &_outgoingFrame, 0) == pdPASS) {
    const auto& frame = _outgoingFrame.header;
    const uint64_t nowUs = esp_timer_get_time();
    if (frame.controllerBootId == _request.controllerBootId && frame.configGeneration == _request.config.generation
        && frame.slotCount == stream::slotCount(_request.config, _role) && nowUs >= frame.captureTimeUs
        && nowUs - frame.captureTimeUs <= stream::FRAME_TIMEOUT_MS * 1000ULL) {
      size_t payloadSize = 0;
      if (protocol::encodeFrameRgbPayload(frame, _outgoingFrame.colors, static_cast<size_t>(frame.slotCount) * 3,
          _payloadBuffer, sizeof(_payloadBuffer), &payloadSize) == protocol::PacketStatus::Ok) {
        return preparePacket(protocol::MessageType::FrameRgb, _payloadBuffer, payloadSize);
      }
    }
  }
  if (preparePreviewChunk()) { _previewTurn = false; return true; }
  return prepareHeartbeat();
}

// Pull responses repeat until the controller advances its offset; RGB gets at least every other slot.
bool SpiSlaveEndpoint::preparePreviewChunk() {
  if (_request.previewId == 0 || !_previewMutex || xSemaphoreTake(_previewMutex, 0) != pdTRUE) return false;
  bool ready = _previewId == _request.previewId && _previewControllerBootId == _request.controllerBootId;
  if (ready) {
    protocol::writeU32Le(_payloadBuffer, _previewId);
    protocol::writeU32Le(_payloadBuffer + 4, _previewControllerBootId);
    protocol::writeU16Le(_payloadBuffer + 8, _request.previewOffset);
    protocol::writeU16Le(_payloadBuffer + 10, preview::CHUNK_SIZE);
    memcpy(_payloadBuffer + preview::HEADER_SIZE, _previewPixels + _request.previewOffset, preview::CHUNK_SIZE);
  }
  xSemaphoreGive(_previewMutex);
  return ready && preparePacket(protocol::MessageType::SnapshotChunk, _payloadBuffer, preview::HEADER_SIZE + preview::CHUNK_SIZE);
}

// Capture converts directly into a PSRAM thumbnail under a bounded mutex; SPI skips it while busy.
bool SpiSlaveEndpoint::publishPreview(const stream::CaptureRequest& request, const uint8_t* image, size_t length, size_t width, size_t height) {
  if (request.previewId == 0 || !_previewMutex || xSemaphoreTake(_previewMutex, pdMS_TO_TICKS(5)) != pdTRUE) return false;
  const bool ready = preview::makeImage(image, length, width, height, _previewPixels);
  if (ready) { _previewId = request.previewId; _previewControllerBootId = request.controllerBootId; }
  xSemaphoreGive(_previewMutex);
  return ready;
}

// Queue copies isolate capture on the Arduino loop task from SPI transmission on core 0.
bool SpiSlaveEndpoint::captureRequest(stream::CaptureRequest* request) const {
  return request && _requestQueue && xQueuePeek(_requestQueue, request, 0) == pdPASS;
}

bool SpiSlaveEndpoint::publishFrame(const stream::Frame& frame) {
  return _frameQueue && xQueueOverwrite(_frameQueue, &frame) == pdPASS;
}

// Encodes each response with a unique packet sequence; RGB frame IDs advance only on real captures.
bool SpiSlaveEndpoint::preparePacket(protocol::MessageType type, const uint8_t* payload, size_t payloadSize) {
  protocol::PacketHeader header;
  header.type = type;
  header.source = _role;
  header.target = protocol::NodeRole::Controller;
  header.sequence = ++_packetSequence;
  header.bootId = _bootId;

  size_t packetSize = 0;
  if (protocol::encodePacket(header, payload, payloadSize, _packetBuffer, sizeof(_packetBuffer), &packetSize) != protocol::PacketStatus::Ok) return false;
  return spi::encodeSlot(_packetBuffer, packetSize, 0, ++_slotSequence, _txBuffer, spi::SLOT_SIZE) == spi::SlotStatus::Ok;
}

void SpiSlaveEndpoint::processReceivedSlot(size_t receivedBytes) {
  if (receivedBytes != spi::SLOT_SIZE) {
    _invalidSlotCount++;
    const uint32_t nowMillis = millis();
    if (static_cast<uint32_t>(nowMillis - _lastErrorLogMillis) >= 1000) {
      Serial.printf("Cinema SPI: truncated slot %u\n", static_cast<unsigned>(receivedBytes));
      _lastErrorLogMillis = nowMillis;
    }
    return;
  }
  spi::SlotView slot;
  const spi::SlotStatus status = spi::decodeSlot(_rxBuffer, spi::SLOT_SIZE, &slot);
  if (status == spi::SlotStatus::Ok || status == spi::SlotStatus::Empty) _validSlotCount++;
  else _invalidSlotCount++;
  if (status == spi::SlotStatus::Ok && _request.accept(slot.packet, _role, esp_timer_get_time())) {
    xQueueOverwrite(_requestQueue, &_request);
  }
  if (status != spi::SlotStatus::Ok && status != spi::SlotStatus::Empty) {
    const uint32_t nowMillis = millis();
    if (static_cast<uint32_t>(nowMillis - _lastErrorLogMillis) >= 1000) {
      Serial.printf("Cinema SPI: invalid slot %u\n", static_cast<unsigned>(status));
      _lastErrorLogMillis = nowMillis;
    }
  }
}

void SpiSlaveEndpoint::reportDiagnostics(uint32_t nowMillis) {
  if (static_cast<uint32_t>(nowMillis - _lastDiagnosticsMillis) < 1000) return;
  _lastDiagnosticsMillis = nowMillis;
  Serial.printf("Cinema SPI slave: transactions=%lu valid-slots=%lu invalid-slots=%lu packet-seq=%lu\n",
    static_cast<unsigned long>(_transactionCount), static_cast<unsigned long>(_validSlotCount), static_cast<unsigned long>(_invalidSlotCount), static_cast<unsigned long>(_packetSequence));
}

} // namespace camera
} // namespace cinema
// AI: end
